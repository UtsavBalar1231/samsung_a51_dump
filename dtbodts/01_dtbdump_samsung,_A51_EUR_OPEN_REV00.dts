/dts-v1/;

/ {
	compatible = "samsung, A51 EUR OPEN REV00", "samsung,EXYNOS9611";
	dtbo-hw_rev = <0x0>;
	dtbo-hw_rev_end = <0x0>;

	__fixups__ {
		abox = "/fragment@sound/__overlay__/sound:samsung,codec:0", "/fragment@sound/__overlay__/sound/rdma@0/cpu:sound-dai:0", "/fragment@sound/__overlay__/sound/rdma@1/cpu:sound-dai:0", "/fragment@sound/__overlay__/sound/rdma@2/cpu:sound-dai:0", "/fragment@sound/__overlay__/sound/rdma@3/cpu:sound-dai:0", "/fragment@sound/__overlay__/sound/rdma@4/cpu:sound-dai:0", "/fragment@sound/__overlay__/sound/rdma@5/cpu:sound-dai:0", "/fragment@sound/__overlay__/sound/rdma@6/cpu:sound-dai:0", "/fragment@sound/__overlay__/sound/rdma@7/cpu:sound-dai:0", "/fragment@sound/__overlay__/sound/wdma@0/cpu:sound-dai:0", "/fragment@sound/__overlay__/sound/wdma@1/cpu:sound-dai:0", "/fragment@sound/__overlay__/sound/wdma@2/cpu:sound-dai:0", "/fragment@sound/__overlay__/sound/wdma@3/cpu:sound-dai:0", "/fragment@sound/__overlay__/sound/wdma@4/cpu:sound-dai:0", "/fragment@sound/__overlay__/sound/sifs0@0/cpu:sound-dai:0", "/fragment@sound/__overlay__/sound/sifs1@0/cpu:sound-dai:0", "/fragment@sound/__overlay__/sound/sifs2@0/cpu:sound-dai:0", "/fragment@15:target:0";
		abox_bt = "/fragment@sound/__overlay__/sound:samsung,aux:4";
		abox_dsif = "/fragment@sound/__overlay__/sound:samsung,codec:20", "/fragment@sound/__overlay__/sound/dsif@0/cpu:sound-dai:0";
		abox_effect = "/fragment@sound/__overlay__/sound:samsung,aux:0";
		abox_rdma_0 = "/fragment@sound/__overlay__/sound/rdma@0/platform:sound-dai:0";
		abox_rdma_1 = "/fragment@sound/__overlay__/sound/rdma@1/platform:sound-dai:0";
		abox_rdma_2 = "/fragment@sound/__overlay__/sound/rdma@2/platform:sound-dai:0";
		abox_rdma_3 = "/fragment@sound/__overlay__/sound/rdma@3/platform:sound-dai:0";
		abox_rdma_4 = "/fragment@sound/__overlay__/sound/rdma@4/platform:sound-dai:0";
		abox_rdma_5 = "/fragment@sound/__overlay__/sound/rdma@5/platform:sound-dai:0";
		abox_rdma_6 = "/fragment@sound/__overlay__/sound/rdma@6/platform:sound-dai:0";
		abox_rdma_7 = "/fragment@sound/__overlay__/sound/rdma@7/platform:sound-dai:0";
		abox_spdy = "/fragment@sound/__overlay__/sound:samsung,codec:24", "/fragment@sound/__overlay__/sound/spdy@0/cpu:sound-dai:0";
		abox_synchronized_ipc = "/fragment@sound/__overlay__/sound/uaif@2/platform:sound-dai:0";
		abox_uaif_0 = "/fragment@sound/__overlay__/sound:samsung,codec:4", "/fragment@sound/__overlay__/sound/uaif@0/cpu:sound-dai:0";
		abox_uaif_1 = "/fragment@sound/__overlay__/sound:samsung,codec:8", "/fragment@sound/__overlay__/sound/uaif@1/cpu:sound-dai:0";
		abox_uaif_2 = "/fragment@sound/__overlay__/sound:samsung,codec:12", "/fragment@sound/__overlay__/sound/uaif@2/cpu:sound-dai:0";
		abox_uaif_4 = "/fragment@sound/__overlay__/sound:samsung,codec:16", "/fragment@sound/__overlay__/sound/uaif@4/cpu:sound-dai:0";
		abox_wdma_0 = "/fragment@sound/__overlay__/sound/wdma@0/platform:sound-dai:0";
		abox_wdma_1 = "/fragment@sound/__overlay__/sound/wdma@1/platform:sound-dai:0";
		abox_wdma_2 = "/fragment@sound/__overlay__/sound/wdma@2/platform:sound-dai:0";
		abox_wdma_3 = "/fragment@sound/__overlay__/sound/wdma@3/platform:sound-dai:0";
		abox_wdma_4 = "/fragment@sound/__overlay__/sound/wdma@4/platform:sound-dai:0";
		android_q_fstab = "/fragment@19:target:0";
		chosen = "/fragment@43:target:0";
		clock = "/fragment@sound/__overlay__/sound:clocks:0", "/fragment@model/__overlay__/etspi-spi@0:clocks:0", "/fragment@model/__overlay__/etspi-spi@0:clocks:8", "/fragment@50/__overlay__:clocks:0", "/fragment@50/__overlay__:clocks:8", "/fragment@53/__overlay__/pn547@2B:clocks:0";
		contexthub_0 = "/fragment@50:target:0";
		decon_f = "/fragment@1:target:0";
		dsim_0 = "/fragment@0:target:0";
		exynos_adc = "/fragment@model/__overlay__/sec_thermistor@0:io-channels:0", "/fragment@model/__overlay__/sec_thermistor@6:io-channels:0", "/fragment@battery/__overlay__/battery:io-channels:0", "/fragment@battery/__overlay__/battery:io-channels:8", "/fragment@battery/__overlay__/battery:io-channels:16";
		fimc_is = "/fragment@2:target:0";
		fimc_is_mclk0_fn = "/fragment@camera/__overlay__/fimc-fimc_is_sensor_imx582@1A:pinctrl-1:0", "/fragment@camera/__overlay__/fimc-is_sensor_gc5035@6E:pinctrl-2:0";
		fimc_is_mclk0_out = "/fragment@camera/__overlay__/fimc-fimc_is_sensor_imx582@1A:pinctrl-0:0", "/fragment@camera/__overlay__/fimc-is_sensor_gc5035@6E:pinctrl-1:0", "/fragment@2/__overlay__:pinctrl-0:0";
		fimc_is_mclk1_fn = "/fragment@camera/__overlay__/fimc-is_sensor_imx616@1A:pinctrl-2:0";
		fimc_is_mclk1_out = "/fragment@camera/__overlay__/fimc-is_sensor_imx616@1A:pinctrl-1:0", "/fragment@2/__overlay__:pinctrl-0:4";
		fimc_is_mclk2_fn = "/fragment@camera/__overlay__/fimc-is_sensor_hi1336@42:pinctrl-1:0", "/fragment@camera/__overlay__/fimc-is_macro_sensor_gc5035@7E:pinctrl-2:0";
		fimc_is_mclk2_out = "/fragment@camera/__overlay__/fimc-is_sensor_hi1336@42:pinctrl-0:0", "/fragment@camera/__overlay__/fimc-is_macro_sensor_gc5035@7E:pinctrl-1:0", "/fragment@2/__overlay__:pinctrl-0:8";
		fimc_is_sensor0 = "/fragment@10:target:0";
		fimc_is_sensor1 = "/fragment@11:target:0";
		fimc_is_sensor2 = "/fragment@12:target:0";
		fimc_is_sensor3 = "/fragment@13:target:0";
		fimc_is_sensor4 = "/fragment@14:target:0";
		fmp_0 = "/fragment@27:target:0";
		gnss_reserved = "/fragment@model/__overlay__/gnss_pdata:memory-region:0";
		gpa0 = "/fragment@lcd/__overlay__/decon_board_s6e3fa9:gpio_pcd:0", "/fragment@lcd/__overlay__/decon_board_s6e3fa9:gpio_det:0", "/fragment@lcd/__overlay__/decon_board_ea8076:gpio_pcd:0", "/fragment@lcd/__overlay__/decon_board_ea8076:gpio_det:0", "/fragment@model/__overlay__/i2c@13870000/mms_ts@48:melfas,irq-gpio:0", "/fragment@model/__overlay__/hall:hall,gpio_flip_cover:0", "/fragment@model/__overlay__/certify_hall:certify_hall,gpio_certify_cover:0", "/fragment@isdbt_data/__overlay__/isdbt_data:isdbt,gpio-tunner-irq:0";
		gpa1 = "/fragment@lcd/__overlay__/decon_board_s6e3fa9:gpio_err:0", "/fragment@lcd/__overlay__/decon_board_ea8076:gpio_err:0", "/fragment@camera/__overlay__/fimc-is-flash-gpio@0:torch-gpio:0", "/fragment@9/__overlay__/sm5713-fled@49/sm5713-fled@0:torch-en-gpio:0", "/fragment@17/__overlay__/rt5665@1b:interrupt-parent:0", "/fragment@model/__overlay__/gpio_keys/button@2:gpios:0", "/fragment@model/__overlay__/gpio_keys/button@3:gpios:0", "/fragment@model/__overlay__/gpio_keys/button@4:gpios:0", "/fragment@53/__overlay__/pn547@2B:interrupt-parent:0", "/fragment@53/__overlay__/pn547@2B:pn547,irq-gpio:0", "/fragment@63/__overlay__/rt5665@1b:realtek,ext-ant-det-gpio:0";
		gpa2 = "/fragment@lcd/__overlay__/decon_board_s6e3fa9:gpio_con:0", "/fragment@lcd/__overlay__/decon_board_ea8076:gpio_con:0", "/fragment@model/__overlay__/speedy@11a10000/s2mpu09mfd@00:s2mpu09,irq-gpio:0", "/fragment@model/__overlay__/speedy@11a10000/s2mpu09mfd@00:interrupt-parent:0", "/fragment@model/__overlay__/dwmmc2@13550000:card-detect:0", "/fragment@model/__overlay__/i2c@20/sx9360_sub-i2c@28:interrupt-parent:0", "/fragment@model/__overlay__/i2c@20/sx9360_sub-i2c@28:sx9360_sub,nirq-gpio:0", "/fragment@44/__overlay__/usbpd-5713@33:usbpd,usbpd_int:0", "/fragment@45/__overlay__/sm5713@49:sm5713,irq-gpio:0", "/fragment@53/__overlay__/pn547@2B:pn547,clk_req-gpio:0", "/fragment@62/__overlay__/sx9360-i2c@28:interrupt-parent:0", "/fragment@62/__overlay__/sx9360-i2c@28:sx9360,nirq-gpio:0";
		gpc0 = "/fragment@3/__overlay__:gpios:0", "/fragment@3/__overlay__:gpios:12", "/fragment@4/__overlay__:gpios:0", "/fragment@4/__overlay__:gpios:12", "/fragment@5/__overlay__:gpios:0", "/fragment@5/__overlay__:gpios:12", "/fragment@6/__overlay__:gpios:0", "/fragment@6/__overlay__:gpios:12";
		gpc1 = "/fragment@7/__overlay__:gpios:0", "/fragment@7/__overlay__:gpios:12", "/fragment@8/__overlay__:gpios:0", "/fragment@8/__overlay__:gpios:12", "/fragment@61/__overlay__/isdbt@0/controller-data:cs-gpio:0", "/fragment@isdbt_data/__overlay__/isdbt_data:isdbt,isdb-gpio-spi_di:0", "/fragment@isdbt_data/__overlay__/isdbt_data:isdbt,isdb-gpio-spi_do:0", "/fragment@isdbt_data/__overlay__/isdbt_data:isdbt,isdb-gpio-spi_cs:0", "/fragment@isdbt_data/__overlay__/isdbt_data:isdbt,isdb-gpio-spi_clk:0";
		gpc2 = "/fragment@camera/__overlay__/fimc-fimc_is_sensor_imx582@1A:gpio_mclk:0", "/fragment@camera/__overlay__/fimc-is_sensor_gc5035@6E:gpio_mclk:0", "/fragment@camera/__overlay__/fimc-is_sensor_hi1336@42:gpio_mclk:0", "/fragment@camera/__overlay__/fimc-is_sensor_imx616@1A:gpio_mclk:0", "/fragment@camera/__overlay__/fimc-is_macro_sensor_gc5035@7E:gpio_mclk:0";
		gpg0 = "/fragment@camera/__overlay__/fimc-is-flash-gpio@0:flash-gpio:0", "/fragment@camera/__overlay__/fimc-is_sensor_gc5035@6E:gpio_reset:0", "/fragment@9/__overlay__/sm5713-fled@49/sm5713-fled@0:flash-en-gpio:0", "/fragment@model/__overlay__/sec-mst:sec-mst,mst-support-gpio:0", "/fragment@50/__overlay__:mag-check-nfc:0", "/fragment@50/__overlay__:mag-check-mst:0", "/fragment@53/__overlay__/pn547@2B:pn547,ven-gpio:0", "/fragment@53/__overlay__/pn547@2B:pn547,check_nfc:0", "/fragment@isdbt_data/__overlay__/isdbt_data:isdbt,gpio-tunner-en:0";
		gpg1 = "/fragment@lcd/__overlay__/decon_board_s6e3fa9:gpio_lcd_rst:0", "/fragment@lcd/__overlay__/decon_board_s6e3fa9:gpio_lcd_en_1p8:0", "/fragment@lcd/__overlay__/decon_board_ea8076:gpio_lcd_rst:0", "/fragment@lcd/__overlay__/decon_board_ea8076:gpio_lcd_en_1p8:0", "/fragment@camera/__overlay__/fimc-fimc_is_sensor_imx582@1A:gpio_reset:0", "/fragment@camera/__overlay__/fimc-is_sensor_hi1336@42:gpio_reset:0", "/fragment@camera/__overlay__/fimc-is_sensor_hi1336@42:gpio_cam_a2p8_en:0", "/fragment@camera/__overlay__/fimc-is_sensor_imx616@1A:gpio_reset:0", "/fragment@53/__overlay__/pn547@2B:pn547,firm-gpio:0";
		gpg2 = "/fragment@lcd/__overlay__/decon_board_s6e3fa9:gpio_lcd_en_3p0:0", "/fragment@lcd/__overlay__/decon_board_ea8076:gpio_lcd_en_3p0:0", "/fragment@camera/__overlay__/fimc-is_macro_sensor_gc5035@7E:gpio_cam_a2p8_1p2_en:0", "/fragment@model/__overlay__/dc_vibrator:dc_vib,gpio_en:0", "/fragment@model/__overlay__/sec_vib/sec_vib_pdata:sec_vib,ldo_en:0", "/fragment@isdbt_data/__overlay__/isdbt_data:isdbt,gpio-fm-dtv-ctrl:0", "/fragment@isdbt_data/__overlay__/isdbt_data:isdbt,gpio-dtv-check:0", "/fragment@63/__overlay__/rt5665@1b:realtek,gpio-dtv-check:0";
		gpg3 = "/fragment@model/__overlay__/mif_pdata:gpios:0", "/fragment@model/__overlay__/mif_pdata:gpios:12", "/fragment@model/__overlay__/mif_pdata:gpios:24", "/fragment@model/__overlay__/mif_pdata:gpios:36", "/fragment@model/__overlay__/tsp_ldo_en:gpio:0", "/fragment@model/__overlay__/etspi-spi@0:etspi-sleepPin:0";
		gpg4 = "/fragment@camera/__overlay__/fimc-is_macro_sensor_gc5035@7E:gpio_reset:0", "/fragment@isdbt_data/__overlay__/isdbt_data:isdbt,gpio-lna-en:0";
		gpm13 = "/fragment@model/__overlay__/sec-mst:sec-mst,mst-data-gpio:0";
		gpm14 = "/fragment@model/__overlay__/sec-mst:sec-mst,mst-en-gpio:0";
		gpm15 = "/fragment@isdbt_data/__overlay__/isdbt_data:isdbt,gpio-tunner-rst:0";
		gpm21 = "/fragment@50/__overlay__:sensor-ldo-en:0";
		gpm22 = "/fragment@camera/__overlay__/fimc-fimc_is_sensor_imx582@1A:gpio_ldo_en:0";
		gpm6 = "/fragment@62/__overlay__:gpios:0";
		gpm7 = "/fragment@62/__overlay__:gpios:12";
		gpp1 = "/fragment@model/__overlay__/i2c@20:gpios:0", "/fragment@model/__overlay__/i2c@20:gpios:12";
		gpp2 = "/fragment@model/__overlay__/etspi-spi@0/controller-data:cs-gpio:0";
		hsi2c12_bus = "/fragment@3/__overlay__:pinctrl-0:0", "/fragment@3/__overlay__:pinctrl-1:0", "/fragment@3/__overlay__:pinctrl-2:0";
		hsi2c13_bus = "/fragment@4/__overlay__:pinctrl-0:0", "/fragment@4/__overlay__:pinctrl-1:0", "/fragment@4/__overlay__:pinctrl-2:0";
		hsi2c14_bus = "/fragment@5/__overlay__:pinctrl-0:0", "/fragment@5/__overlay__:pinctrl-1:0", "/fragment@5/__overlay__:pinctrl-2:0";
		hsi2c15_bus = "/fragment@6/__overlay__:pinctrl-0:0", "/fragment@6/__overlay__:pinctrl-1:0", "/fragment@6/__overlay__:pinctrl-2:0";
		hsi2c16_bus = "/fragment@7/__overlay__:pinctrl-0:0", "/fragment@7/__overlay__:pinctrl-1:0", "/fragment@7/__overlay__:pinctrl-2:0";
		hsi2c17_bus = "/fragment@8/__overlay__:pinctrl-0:0", "/fragment@8/__overlay__:pinctrl-1:0", "/fragment@8/__overlay__:pinctrl-2:0";
		hsi2c5_bus = "/fragment@62/__overlay__:pinctrl-0:0";
		hsi2c_12 = "/fragment@3:target:0";
		hsi2c_13 = "/fragment@4:target:0";
		hsi2c_14 = "/fragment@5:target:0";
		hsi2c_15 = "/fragment@6:target:0";
		hsi2c_16 = "/fragment@7:target:0";
		hsi2c_17 = "/fragment@8:target:0";
		hsi2c_3 = "/fragment@16:target:0";
		hsi2c_5 = "/fragment@62:target:0";
		hsi2c_6 = "/fragment@53:target:0";
		i2c_0 = "/fragment@44:target:0";
		i2c_1 = "/fragment@9:target:0", "/fragment@45:target:0";
		i2c_3 = "/fragment@46:target:0";
		i2c_6 = "/fragment@17:target:0", "/fragment@63:target:0";
		mipi_phy_csis_m2s4s4s2 = "/fragment@11/__overlay__:phys:0", "/fragment@13/__overlay__:phys:0";
		pdma0 = "/fragment@61/__overlay__:dmas:0", "/fragment@61/__overlay__:dmas:8";
		pinctrl_0 = "/fragment@25:target:0", "/fragment@51:target:0", "/fragment@54:target:0", "/fragment@60:target:0", "/fragment@64:target:0";
		pinctrl_1 = "/fragment@55:target:0", "/fragment@59:target:0";
		pinctrl_2 = "/fragment@56:target:0";
		pinctrl_4 = "/fragment@26:target:0", "/fragment@48:target:0", "/fragment@49:target:0", "/fragment@52:target:0", "/fragment@57:target:0", "/fragment@58:target:0", "/fragment@65:target:0";
		reserved_memory = "/fragment@47:target:0";
		sd2_bus1 = "/fragment@model/__overlay__/dwmmc2@13550000:pinctrl-0:8";
		sd2_bus4 = "/fragment@model/__overlay__/dwmmc2@13550000:pinctrl-0:12";
		sd2_clk = "/fragment@model/__overlay__/dwmmc2@13550000:pinctrl-0:0";
		sd2_clk_fast_slew_rate_1x = "/fragment@model/__overlay__/dwmmc2@13550000:pinctrl-1:0";
		sd2_clk_fast_slew_rate_2x = "/fragment@model/__overlay__/dwmmc2@13550000:pinctrl-2:0";
		sd2_clk_fast_slew_rate_3x = "/fragment@model/__overlay__/dwmmc2@13550000:pinctrl-3:0";
		sd2_clk_fast_slew_rate_4x = "/fragment@model/__overlay__/dwmmc2@13550000:pinctrl-4:0";
		sd2_cmd = "/fragment@model/__overlay__/dwmmc2@13550000:pinctrl-0:4";
		serial_0 = "/fragment@24:target:0";
		shared_meta = "/fragment@18:target:0";
		spi9_bus = "/fragment@61/__overlay__:pinctrl-0:0";
		spi9_cs = "/fragment@61/__overlay__:pinctrl-0:4";
		spi_9 = "/fragment@61:target:0", "/fragment@isdbt_data/__overlay__/isdbt_data:isdbt,spi-node:0";
		udc = "/fragment@model/__overlay__/usb_notifier:udc:0", "/fragment@20:target:0";
		usbdrd3_phy = "/fragment@23:target:0";
		usbdrd_dwc3 = "/fragment@21:target:0";
		usbdrd_phy = "/fragment@22:target:0";
		usi_0_cmgp = "/fragment@30:target:0";
		usi_0_cmgp_i2c = "/fragment@31:target:0";
		usi_0_shub = "/fragment@28:target:0";
		usi_0_shub_i2c = "/fragment@29:target:0";
		usi_1_cmgp = "/fragment@32:target:0";
		usi_1_cmgp_i2c = "/fragment@33:target:0";
		usi_2_cmgp = "/fragment@34:target:0";
		usi_2_cmgp_i2c = "/fragment@35:target:0";
		usi_3_cmgp = "/fragment@36:target:0";
		usi_3_cmgp_i2c = "/fragment@37:target:0";
		usi_4_cmgp = "/fragment@38:target:0";
		usi_4_cmgp_i2c = "/fragment@39:target:0";
		usi_peri_spi_1 = "/fragment@42:target:0";
		usi_peri_usi_0 = "/fragment@40:target:0";
		usi_peri_usi_0_i2c = "/fragment@41:target:0";
		xclkout0 = "/fragment@sound/__overlay__/sound:pinctrl-0:0";
		xclkout1 = "/fragment@53/__overlay__/pn547@2B:pinctrl-0:12";
	};

	__local_fixups__ {

		fragment@0 {

			__overlay__ {
				lcd_info = <0x0>;
			};
		};

		fragment@17 {

			__overlay__ {

				rt5665@1b {
					pinctrl-0 = <0x0 0x4>;
					realtek,regulator_1v8 = <0x0>;
					realtek,regulator_3v3 = <0x0>;
				};
			};
		};

		fragment@22 {

			__overlay__ {
				hs_tune_param = <0x0>;
			};
		};

		fragment@23 {

			__overlay__ {
				hs_tune_param = <0x0>;
				ss_tune_param = <0x0>;
			};
		};

		fragment@44 {

			__overlay__ {

				usbpd-5713@33 {
					pinctrl-0 = <0x0>;
				};
			};
		};

		fragment@45 {

			__overlay__ {

				sm5713@49 {
					pinctrl-0 = <0x0 0x4>;
				};
			};
		};

		fragment@53 {

			__overlay__ {

				pn547@2B {
					pinctrl-0 = <0x0 0x4 0x8 0x10 0x14>;
					pinctrl-1 = <0x0 0x4 0x8 0xc 0x10>;
				};
			};
		};

		fragment@54 {

			__overlay__ {
				pinctrl-0 = <0x0>;
			};
		};

		fragment@55 {

			__overlay__ {
				pinctrl-0 = <0x0>;
			};
		};

		fragment@56 {

			__overlay__ {
				pinctrl-0 = <0x0>;
			};
		};

		fragment@57 {

			__overlay__ {
				pinctrl-0 = <0x0>;
				pinctrl-1 = <0x0>;
			};
		};

		fragment@61 {

			__overlay__ {
				pinctrl-1 = <0x0>;
			};
		};

		fragment@62 {

			__overlay__ {

				sx9360-i2c@28 {
					pinctrl-0 = <0x0>;
				};
			};
		};

		fragment@isdbt_data {

			__overlay__ {

				isdbt_data {
					pinctrl-0 = <0x0 0x4 0x8>;
					pinctrl-1 = <0x0 0x4 0x8>;
				};
			};
		};

		fragment@lcd {

			__overlay__ {

				ea8076 {
					decon_board = <0x0>;
				};

				s6e3fa9 {
					decon_board = <0x0>;
				};
			};
		};

		fragment@model {

			__overlay__ {

				certify_hall {
					pinctrl-0 = <0x0>;
				};

				dc_vibrator {
					pinctrl-0 = <0x0>;
				};

				dwmmc2@13550000 {
					pinctrl-0 = <0x10>;
				};

				etspi-spi@0 {
					pinctrl-0 = <0x0>;
					pinctrl-1 = <0x0 0x4 0x8 0xc>;
					pinctrl-2 = <0x0 0x4>;
				};

				gnss_pdata {
					mbox_info = <0x0>;
				};

				gpio_keys {
					pinctrl-0 = <0x0 0x4 0x8>;
				};

				hall {
					pinctrl-0 = <0x0>;
				};

				i2c@13870000 {

					mms_ts@48 {
						pinctrl-0 = <0x0>;
						pinctrl-1 = <0x0>;
					};
				};

				i2c@20 {
					pinctrl-0 = <0x0>;

					sx9360_sub-i2c@28 {
						pinctrl-0 = <0x0>;
					};
				};

				speedy@11a10000 {

					s2mpu09mfd@00 {
						pinctrl-0 = <0x0 0x4>;
					};
				};
			};
		};

		fragment@sound {

			__overlay__ {

				sound {

					dsif@0 {

						codec {
							sound-dai = <0x0>;
						};
					};

					rdma@0 {

						codec {
							sound-dai = <0x0>;
						};
					};

					rdma@1 {

						codec {
							sound-dai = <0x0>;
						};
					};

					rdma@2 {

						codec {
							sound-dai = <0x0>;
						};
					};

					rdma@3 {

						codec {
							sound-dai = <0x0>;
						};
					};

					rdma@4 {

						codec {
							sound-dai = <0x0>;
						};
					};

					rdma@5 {

						codec {
							sound-dai = <0x0>;
						};
					};

					rdma@6 {

						codec {
							sound-dai = <0x0>;
						};
					};

					rdma@7 {

						codec {
							sound-dai = <0x0>;
						};
					};

					sifs0@0 {

						codec {
							sound-dai = <0x0>;
						};
					};

					sifs1@0 {

						codec {
							sound-dai = <0x0>;
						};
					};

					sifs2@0 {

						codec {
							sound-dai = <0x0>;
						};
					};

					spdy@0 {

						codec {
							sound-dai = <0x0>;
						};
					};

					uaif@0 {

						codec {
							sound-dai = <0x0>;
						};
					};

					uaif@1 {

						codec {
							sound-dai = <0x0>;
						};
					};

					uaif@2 {

						codec {
							sound-dai = <0x0>;
						};
					};

					uaif@4 {

						codec {
							sound-dai = <0x0>;
						};
					};

					wdma@0 {

						codec {
							sound-dai = <0x0>;
						};
					};

					wdma@1 {

						codec {
							sound-dai = <0x0>;
						};
					};

					wdma@2 {

						codec {
							sound-dai = <0x0>;
						};
					};

					wdma@3 {

						codec {
							sound-dai = <0x0>;
						};
					};

					wdma@4 {

						codec {
							sound-dai = <0x0>;
						};
					};
				};
			};
		};
	};

	__symbols__ {
		V_SYS = "/fragment@model/__overlay__/fixedregulator@1";
		__ldo1_reg = "/fragment@46/__overlay__/s2mpb03@56/regulators/s2mpb03-ldo1";
		__ldo2_reg = "/fragment@46/__overlay__/s2mpb03@56/regulators/s2mpb03-ldo2";
		__ldo3_reg = "/fragment@46/__overlay__/s2mpb03@56/regulators/s2mpb03-ldo3";
		__ldo4_reg = "/fragment@46/__overlay__/s2mpb03@56/regulators/s2mpb03-ldo4";
		__ldo5_reg = "/fragment@46/__overlay__/s2mpb03@56/regulators/s2mpb03-ldo5";
		__ldo6_reg = "/fragment@46/__overlay__/s2mpb03@56/regulators/s2mpb03-ldo6";
		__ldo7_reg = "/fragment@46/__overlay__/s2mpb03@56/regulators/s2mpb03-ldo7";
		attn_input = "/fragment@25/__overlay__/attn-input";
		attn_irq = "/fragment@25/__overlay__/attn-irq";
		b1_reg = "/fragment@model/__overlay__/speedy@11a10000/s2mpu09mfd@00/regulators/BUCK1";
		b2_reg = "/fragment@model/__overlay__/speedy@11a10000/s2mpu09mfd@00/regulators/BUCK2";
		b3_reg = "/fragment@model/__overlay__/speedy@11a10000/s2mpu09mfd@00/regulators/BUCK3";
		b4_reg = "/fragment@model/__overlay__/speedy@11a10000/s2mpu09mfd@00/regulators/BUCK4";
		b5_reg = "/fragment@model/__overlay__/speedy@11a10000/s2mpu09mfd@00/regulators/BUCK5";
		b6_reg = "/fragment@model/__overlay__/speedy@11a10000/s2mpu09mfd@00/regulators/BUCK6";
		b7_reg = "/fragment@model/__overlay__/speedy@11a10000/s2mpu09mfd@00/regulators/BUCK7";
		b8_reg = "/fragment@model/__overlay__/speedy@11a10000/s2mpu09mfd@00/regulators/BUCK8";
		b9_reg = "/fragment@model/__overlay__/speedy@11a10000/s2mpu09mfd@00/regulators/BUCK9";
		btp_rst = "/fragment@49/__overlay__/btp-rst";
		certify_hall_irq = "/fragment@25/__overlay__/certify-hall-irq";
		chg_en = "/fragment@48/__overlay__/chg-en";
		codec_irq = "/fragment@25/__overlay__/codec_irq";
		decon_board_ea8076 = "/fragment@lcd/__overlay__/decon_board_ea8076";
		decon_board_s6e3fa9 = "/fragment@lcd/__overlay__/decon_board_s6e3fa9";
		dummy_audio_codec = "/fragment@sound/__overlay__/audio_codec_dummy";
		dummy_audio_cpu = "/fragment@sound/__overlay__/audio_cpu_dummy";
		dwmmc2_cd_ext_irq = "/fragment@25/__overlay__/dwmmc2_cd_ext_irq";
		ea8076 = "/fragment@lcd/__overlay__/ea8076";
		earant_det = "/fragment@64/__overlay__/earant-det";
		ext_bin_0 = "/fragment@15/__overlay__/ext_bin@0";
		ext_bin_1 = "/fragment@15/__overlay__/ext_bin@1";
		ext_bin_2 = "/fragment@15/__overlay__/ext_bin@2";
		ext_bin_4 = "/fragment@15/__overlay__/ext_bin@4";
		ext_bin_5 = "/fragment@15/__overlay__/ext_bin@5";
		fimc_is_flash_gpio = "/fragment@camera/__overlay__/fimc-is-flash-gpio@0";
		fimc_is_macro_module_gc5035 = "/fragment@camera/__overlay__/fimc-is_macro_sensor_gc5035@7E";
		fimc_is_module_gc5035 = "/fragment@camera/__overlay__/fimc-is_sensor_gc5035@6E";
		fimc_is_sensor_hi1336 = "/fragment@camera/__overlay__/fimc-is_sensor_hi1336@42";
		fimc_is_sensor_imx582 = "/fragment@camera/__overlay__/fimc-fimc_is_sensor_imx582@1A";
		fimc_is_sensor_imx616 = "/fragment@camera/__overlay__/fimc-is_sensor_imx616@1A";
		grip_int = "/fragment@64/__overlay__/grip-int";
		grip_sub_i2c = "/fragment@65/__overlay__/grip-sub-i2c";
		grip_sub_int = "/fragment@64/__overlay__/grip-sub-int";
		hall_irq = "/fragment@25/__overlay__/hall-irq";
		i2c_4 = "/fragment@model/__overlay__/i2c@13870000";
		if_pmic_irq = "/fragment@25/__overlay__/if-pmic-irq";
		initial0 = "/fragment@54/__overlay__/initial-state";
		initial1 = "/fragment@55/__overlay__/initial-state";
		initial4 = "/fragment@57/__overlay__/initial-state";
		isdbt_gpio_active = "/fragment@58/__overlay__/isdbt-gpio-active";
		isdbt_gpio_suspend = "/fragment@58/__overlay__/isdbt-gpio-suspend";
		isdbt_irq_off = "/fragment@60/__overlay__/isdbt-irq-off";
		isdbt_irq_on = "/fragment@60/__overlay__/isdbt-irq-on";
		isdbt_rst_active = "/fragment@59/__overlay__/isdbt-rst-active";
		isdbt_rst_suspend = "/fragment@59/__overlay__/isdbt-rst-suspend";
		key_power = "/fragment@25/__overlay__/key-power";
		key_voldown = "/fragment@25/__overlay__/key-voldown";
		key_volup = "/fragment@25/__overlay__/key-volup";
		l10_reg = "/fragment@model/__overlay__/speedy@11a10000/s2mpu09mfd@00/regulators/LDO10";
		l11_reg = "/fragment@model/__overlay__/speedy@11a10000/s2mpu09mfd@00/regulators/LDO11";
		l12_reg = "/fragment@model/__overlay__/speedy@11a10000/s2mpu09mfd@00/regulators/LDO12";
		l13_reg = "/fragment@model/__overlay__/speedy@11a10000/s2mpu09mfd@00/regulators/LDO13";
		l14_reg = "/fragment@model/__overlay__/speedy@11a10000/s2mpu09mfd@00/regulators/LDO14";
		l1_reg = "/fragment@model/__overlay__/speedy@11a10000/s2mpu09mfd@00/regulators/LDO1";
		l2_reg = "/fragment@model/__overlay__/speedy@11a10000/s2mpu09mfd@00/regulators/LDO2";
		l33_reg = "/fragment@model/__overlay__/speedy@11a10000/s2mpu09mfd@00/regulators/LDO33";
		l34_reg = "/fragment@model/__overlay__/speedy@11a10000/s2mpu09mfd@00/regulators/LDO34";
		l35_reg = "/fragment@model/__overlay__/speedy@11a10000/s2mpu09mfd@00/regulators/LDO35";
		l36_reg = "/fragment@model/__overlay__/speedy@11a10000/s2mpu09mfd@00/regulators/LDO36";
		l37_reg = "/fragment@model/__overlay__/speedy@11a10000/s2mpu09mfd@00/regulators/LDO37";
		l38_reg = "/fragment@model/__overlay__/speedy@11a10000/s2mpu09mfd@00/regulators/LDO38";
		l39_reg = "/fragment@model/__overlay__/speedy@11a10000/s2mpu09mfd@00/regulators/LDO39";
		l3_reg = "/fragment@model/__overlay__/speedy@11a10000/s2mpu09mfd@00/regulators/LDO3";
		l40_reg = "/fragment@model/__overlay__/speedy@11a10000/s2mpu09mfd@00/regulators/LDO40";
		l41_reg = "/fragment@model/__overlay__/speedy@11a10000/s2mpu09mfd@00/regulators/LDO41";
		l42_reg = "/fragment@model/__overlay__/speedy@11a10000/s2mpu09mfd@00/regulators/LDO42";
		l43_reg = "/fragment@model/__overlay__/speedy@11a10000/s2mpu09mfd@00/regulators/LDO43";
		l44_reg = "/fragment@model/__overlay__/speedy@11a10000/s2mpu09mfd@00/regulators/LDO44";
		l4_reg = "/fragment@model/__overlay__/speedy@11a10000/s2mpu09mfd@00/regulators/LDO4";
		l5_reg = "/fragment@model/__overlay__/speedy@11a10000/s2mpu09mfd@00/regulators/LDO5";
		l6_reg = "/fragment@model/__overlay__/speedy@11a10000/s2mpu09mfd@00/regulators/LDO6";
		l7_reg = "/fragment@model/__overlay__/speedy@11a10000/s2mpu09mfd@00/regulators/LDO7";
		l8_reg = "/fragment@model/__overlay__/speedy@11a10000/s2mpu09mfd@00/regulators/LDO8";
		l9_reg = "/fragment@model/__overlay__/speedy@11a10000/s2mpu09mfd@00/regulators/LDO9";
		mailbox_cp = "/fragment@model/__overlay__/mcu_ipc@11920000";
		mailbox_gnss = "/fragment@model/__overlay__/mcu_ipc@11A00000";
		motor_en = "/fragment@26/__overlay__/motor-en";
		nfc_check = "/fragment@52/__overlay__/nfc-check";
		nfc_clk_req = "/fragment@51/__overlay__/nfc_clk_req";
		nfc_clk_req_nc = "/fragment@51/__overlay__/nfc_clk_req_nc";
		nfc_en = "/fragment@52/__overlay__/nfc_en";
		nfc_en_nc = "/fragment@52/__overlay__/nfc_en_nc";
		nfc_firm = "/fragment@52/__overlay__/nfc_firm";
		nfc_firm_nc = "/fragment@52/__overlay__/nfc_firm_nc";
		nfc_pwr_en = "/fragment@52/__overlay__/nfc_pwr_en";
		nfc_pwr_en_nc = "/fragment@52/__overlay__/nfc_pwr_en_nc";
		pm_wrsti = "/fragment@26/__overlay__/pm-wrsti";
		pmic_irq = "/fragment@25/__overlay__/pmic-irq";
		rt5510_amp = "/fragment@16/__overlay__/rt5510@34";
		rt5665 = "/fragment@17/__overlay__/rt5665@1b";
		s6e3fa9 = "/fragment@lcd/__overlay__/s6e3fa9";
		sensor3_ch_mode0 = "/fragment@13/__overlay__/sensor3-ch-mode0";
		shmem = "/fragment@modemif/__overlay__/shmem@F0000000";
		sleep2 = "/fragment@56/__overlay__/sleep-state";
		sleep4 = "/fragment@57/__overlay__/sleep-state";
		sm5713_pdic = "/fragment@44/__overlay__/usbpd-5713@33";
		spi7_bus_inactive = "/fragment@49/__overlay__/spi7-bus-inactive";
		spi7_clk = "/fragment@49/__overlay__/spi7-clk";
		spi7_cs = "/fragment@49/__overlay__/spi7-cs";
		spi7_miso = "/fragment@49/__overlay__/spi7-miso";
		spi7_miso_inactive = "/fragment@49/__overlay__/spi17-miso-inactive";
		spi7_mosi = "/fragment@49/__overlay__/spi7-mosi";
		spi9_bus_suspend = "/fragment@58/__overlay__/spi9-bus-suspend";
		usb3_hs_tune = "/fragment@model/__overlay__/usb3_hs_tune";
		usb3_ss_tune = "/fragment@model/__overlay__/usb3_ss_tune";
		usb_hs_tune = "/fragment@model/__overlay__/usb_hs_tune";
		usbpd_irq = "/fragment@25/__overlay__/usbpd-irq";
		xclkout1_nc = "/fragment@51/__overlay__/xclkout1_nc";
	};

	fragment@0 {
		target = <0xffffffff>;

		__overlay__ {
			lcd_info = <0x3>;
		};
	};

	fragment@1 {
		target = <0xffffffff>;

		__overlay__ {
			dsi_mode = <0x0>;
			psr_mode = <0x2>;
			trig_mode = <0x0>;
		};
	};

	fragment@10 {
		target = <0xffffffff>;

		__overlay__ {
			camif_mux_val = <0x182077>;
			csi_ch = <0x0>;
			csi_mux = <0x2>;
			dma_ch = <0x0 0x0 0x0 0x0 0x0 0x0 0x2 0x0>;
			flite_ch = <0x64>;
			id = <0x0>;
			is_bns = <0x0>;
			multi_ch = <0x2>;
			scenario = <0x0>;
			status = "okay";
			use_ssvc2_internal;
			use_ssvc3_internal;
			vc_ch = <0x0 0x1 0x2 0x3 0x0 0x1 0x0 0x3>;
		};
	};

	fragment@11 {
		target = <0xffffffff>;

		__overlay__ {
			camif_mux_val = <0x182077>;
			csi_ch = <0x1>;
			csi_mux = <0x2>;
			dma_ch = <0x1 0x1 0x1 0x1 0x2 0x2 0x2 0x2>;
			flite_ch = <0x64>;
			id = <0x2>;
			is_bns = <0x0>;
			multi_ch = <0x2>;
			phys = <0xffffffff 0x1>;
			scenario = <0x0>;
			status = "okay";
			vc_ch = <0x0 0x1 0x2 0x3 0x1 0x2 0x1 0x3>;
		};
	};

	fragment@12 {
		target = <0xffffffff>;

		__overlay__ {
			camif_mux_val = <0x2077>;
			camif_mux_val_s = <0x184240>;
			csi_ch = <0x2>;
			csi_mux = <0x2>;
			dma_ch = <0x2 0x2 0x2 0x2>;
			flite_ch = <0x64>;
			id = <0x1>;
			is_bns = <0x0>;
			multi_ch = <0x0>;
			scenario = <0x0>;
			status = "okay";
			use_ssvc2_internal;
			use_ssvc3_internal;
			vc_ch = <0x0 0x1 0x2 0x3>;
		};
	};

	fragment@13 {
		target = <0xffffffff>;

		__overlay__ {
			camif_mux_val = <0x182077>;
			csi_ch = <0x1>;
			csi_mux = <0x0>;
			dma_ch = <0x1 0x1 0x1 0x1>;
			flite_ch = <0x64>;
			id = <0x3>;
			interrupt-names = "csi", "mode0_VC0", "mode0_VC1", "mode0_VC2", "mode0_VC3";
			interrupts = <0x0 0x146 0x0 0x0 0x14c 0x0 0x0 0x14c 0x0 0x0 0x14c 0x0 0x0 0x14c 0x0>;
			is_bns = <0x0>;
			multi_ch = <0x2>;
			phys = <0xffffffff 0x0>;
			reg = <0x0 0x14410700 0x100 0x0 0x14410000 0x700>;
			reg-names = "phy", "csi";
			scenario = <0x0>;
			status = "okay";
			vc_ch = <0x0 0x1 0x2 0x3>;

			sensor3-ch-mode0 {
				linux,phandle = <0x44>;
				phandle = <0x44>;
				reg = <0x14460000 0x100 0x14460400 0x100 0x14460100 0x100 0x14460400 0x100 0x14460200 0x100 0x14460400 0x100 0x14460300 0x100 0x14460400 0x100>;
			};
		};
	};

	fragment@14 {
		target = <0xffffffff>;

		__overlay__ {
			camif_mux_val = <0x60ff>;
			csi_ch = <0x3>;
			csi_mux = <0x0>;
			dma_ch = <0x3 0x3 0x3 0x3>;
			flite_ch = <0x64>;
			id = <0x4>;
			is_bns = <0x0>;
			multi_ch = <0x0>;
			scenario = <0x0>;
			status = "okay";
			vc_ch = <0x0 0x1 0x2 0x3>;
		};
	};

	fragment@15 {
		target = <0xffffffff>;

		__overlay__ {

			ext_bin@0 {
				linux,phandle = <0x46>;
				phandle = <0x46>;
				samsung,area = <0x1>;
				samsung,name = "rtdsp.bin";
				samsung,offset = <0x502000>;
				status = "okay";
			};

			ext_bin@1 {
				linux,phandle = <0x47>;
				phandle = <0x47>;
				samsung,area = <0x1>;
				samsung,name = "AP_AUDIO_SLSI.bin";
				samsung,offset = <0x7f0000>;
				status = "okay";
			};

			ext_bin@2 {
				linux,phandle = <0x48>;
				phandle = <0x48>;
				samsung,area = <0x1>;
				samsung,name = "APBargeIn_AUDIO_SLSI.bin";
				samsung,offset = <0x7ec000>;
				status = "okay";
			};

			ext_bin@4 {
				linux,phandle = <0x49>;
				phandle = <0x49>;
				samsung,area = <0x1>;
				samsung,name = "rtdsp_param.bin";
				samsung,offset = <0x582000>;
				status = "okay";
			};

			ext_bin@5 {
				linux,phandle = <0x4a>;
				phandle = <0x4a>;
				samsung,area = <0x1>;
				samsung,name = "APBiBF_AUDIO_SLSI.bin";
				samsung,offset = <0x7ef000>;
				status = "okay";
			};
		};
	};

	fragment@16 {
		target = <0xffffffff>;

		__overlay__ {
			#address-cells = <0x1>;
			#size-cells = <0x0>;
			status = "okay";

			rt5510@34 {
				#sound-dai-cells = <0x1>;
				compatible = "richtek,rt5510";
				linux,phandle = <0x6>;
				phandle = <0x6>;
				reg = <0x34>;
				status = "okay";
			};
		};
	};

	fragment@17 {
		target = <0xffffffff>;

		__overlay__ {
			#address-cells = <0x1>;
			#size-cells = <0x0>;
			status = "okay";

			rt5665@1b {
				#sound-dai-cells = <0x1>;
				compatible = "realtek,rt5665";
				imp_table = <0x0 0xd 0x3 0x6 0xe 0x19 0x1 0x6 0x1a 0x35 0x0 0x6 0x36 0x67 0x0 0x6 0x68 0xffff 0x0 0x6>;
				interrupt-parent = <0xffffffff>;
				interrupts = <0x2 0x0 0x0>;
				linux,phandle = <0x5>;
				phandle = <0x5>;
				pinctrl-0 = <0x7 0x8>;
				pinctrl-names = "default";
				realtek,dmic2-data-pin = <0x2>;
				realtek,in1-differential;
				realtek,in3-differential;
				realtek,in4-differential;
				realtek,jd-src = <0x2>;
				realtek,mic-check-in-bg;
				realtek,offset-comp = <0x78 0x90 0xb0 0xc0 0xf0 0x110 0x130 0x180 0x1e0 0x200 0x2a0 0x300 0x3a0 0x400 0x500 0x600>;
				realtek,offset-comp-r = <0x1a 0x1f 0x20 0x2a 0x30 0x40 0x50 0x60 0x6f 0x7f 0xa0 0xb0 0xcf 0x100 0x120 0x160>;
				realtek,regulator_1v8 = <0x9>;
				realtek,regulator_3v3 = <0xa>;
				realtek,sar-hs-type = <0x2bc>;
				realtek,sar-pb-vth0 = <0x5f>;
				realtek,sar-pb-vth1 = <0x8b>;
				realtek,sar-pb-vth2 = <0xf6>;
				realtek,sar-pb-vth3 = <0x244>;
				reg = <0x1b>;
			};
		};
	};

	fragment@18 {
		target = <0xffffffff>;

		__overlay__ {
			parts = "vbmeta,boot,system,vendor,product,odm,prism,optics,vbmeta_samsung,recovery,dtbo,keystorage";
			status = "okay";
		};
	};

	fragment@19 {
		target = <0xffffffff>;

		__overlay__ {
			status = "disabled";
		};
	};

	fragment@2 {
		target = <0xffffffff>;

		__overlay__ {
			non_secure_mem_info = <0xdb900000 0x700000>;
			pinctrl-0 = <0xffffffff 0xffffffff 0xffffffff>;
			pinctrl-1;
			pinctrl-names = "default", "release";
			secure_mem_info = <0xe1900000 0x2000000>;

			fimc_is_dvfs {

				table0 {
					default_cam = <0xa8750>;
					default_hpg = <0x1>;
					default_int = <0x186a0>;
					default_int_cam = <0xa8750>;
					default_mif = <0x1fefc8>;
					desc = "dvfs table v0.0 for 48M/32M";
					dual_capture_cam = <0xa6040>;
					dual_capture_hpg = <0x1>;
					dual_capture_int = <0x186a0>;
					dual_capture_int_cam = <0xa6040>;
					dual_capture_mif = <0x1fefc8>;
					dual_preview_cam = <0xa6040>;
					dual_preview_hpg = <0x1>;
					dual_preview_int = <0x186a0>;
					dual_preview_int_cam = <0xa1220>;
					dual_preview_mif = <0x1fefc8>;
					dual_sync_capture_cam = <0xa6040>;
					dual_sync_capture_hpg = <0x1>;
					dual_sync_capture_int = <0x186a0>;
					dual_sync_capture_int_cam = <0xa6040>;
					dual_sync_capture_mif = <0x1fefc8>;
					dual_sync_preview_cam = <0xa6040>;
					dual_sync_preview_hpg = <0x1>;
					dual_sync_preview_int = <0x186a0>;
					dual_sync_preview_int_cam = <0xa6040>;
					dual_sync_preview_mif = <0x1fefc8>;
					dual_sync_preview_whd_cam = <0xa6040>;
					dual_sync_preview_whd_hpg = <0x1>;
					dual_sync_preview_whd_int = <0x186a0>;
					dual_sync_preview_whd_int_cam = <0xa6040>;
					dual_sync_preview_whd_mif = <0x1fefc8>;
					dual_sync_video_fhd_cam = <0xa6040>;
					dual_sync_video_fhd_capture_cam = <0xa6040>;
					dual_sync_video_fhd_capture_hpg = <0x1>;
					dual_sync_video_fhd_capture_int = <0x186a0>;
					dual_sync_video_fhd_capture_int_cam = <0xa3930>;
					dual_sync_video_fhd_capture_mif = <0x1e8c50>;
					dual_sync_video_fhd_hpg = <0x1>;
					dual_sync_video_fhd_int = <0x186a0>;
					dual_sync_video_fhd_int_cam = <0xa3930>;
					dual_sync_video_fhd_mif = <0x177bb8>;
					dual_sync_video_uhd_cam = <0xa6040>;
					dual_sync_video_uhd_capture_cam = <0xa6040>;
					dual_sync_video_uhd_capture_hpg = <0x1>;
					dual_sync_video_uhd_capture_int = <0x186a0>;
					dual_sync_video_uhd_capture_int_cam = <0xa6040>;
					dual_sync_video_uhd_capture_mif = <0x1e8c50>;
					dual_sync_video_uhd_hpg = <0x1>;
					dual_sync_video_uhd_int = <0x186a0>;
					dual_sync_video_uhd_int_cam = <0xa6040>;
					dual_sync_video_uhd_mif = <0x1e8c50>;
					dual_sync_whd_capture_cam = <0xa6040>;
					dual_sync_whd_capture_hpg = <0x1>;
					dual_sync_whd_capture_int = <0x186a0>;
					dual_sync_whd_capture_int_cam = <0xa6040>;
					dual_sync_whd_capture_mif = <0x1fefc8>;
					dual_video_fhd_cam = <0xa6040>;
					dual_video_fhd_capture_cam = <0xa6040>;
					dual_video_fhd_capture_hpg = <0x1>;
					dual_video_fhd_capture_int = <0x186a0>;
					dual_video_fhd_capture_int_cam = <0xa3930>;
					dual_video_fhd_capture_mif = <0x177bb8>;
					dual_video_fhd_hpg = <0x1>;
					dual_video_fhd_int = <0x186a0>;
					dual_video_fhd_int_cam = <0xa1220>;
					dual_video_fhd_mif = <0x14a140>;
					dual_video_uhd_cam = <0xa6040>;
					dual_video_uhd_capture_cam = <0xa6040>;
					dual_video_uhd_capture_hpg = <0x1>;
					dual_video_uhd_capture_int = <0x186a0>;
					dual_video_uhd_capture_int_cam = <0xa6040>;
					dual_video_uhd_capture_mif = <0x1b5fd0>;
					dual_video_uhd_hpg = <0x1>;
					dual_video_uhd_int = <0x186a0>;
					dual_video_uhd_int_cam = <0xa3930>;
					dual_video_uhd_mif = <0x177bb8>;
					ext_front_cam = <0xa8750>;
					ext_front_hpg = <0x1>;
					ext_front_int = <0x186a0>;
					ext_front_int_cam = <0xa8750>;
					ext_front_mif = <0x1fefc8>;
					ext_secure_cam = <0xa8750>;
					ext_secure_hpg = <0x1>;
					ext_secure_int = <0x186a0>;
					ext_secure_int_cam = <0xa8750>;
					ext_secure_mif = <0x1fefc8>;
					front_capture_cam = <0xa6040>;
					front_capture_hpg = <0x1>;
					front_capture_int = <0x186a0>;
					front_capture_int_cam = <0xa6040>;
					front_capture_mif = <0x1fefc8>;
					front_capture_remosaic_cam = <0xa8750>;
					front_capture_remosaic_hpg = <0x1>;
					front_capture_remosaic_int = <0x186a0>;
					front_capture_remosaic_int_cam = <0xa6040>;
					front_capture_remosaic_mif = <0x1fefc8>;
					front_preview_cam = <0xa6040>;
					front_preview_full_cam = <0xa6040>;
					front_preview_full_hpg = <0x1>;
					front_preview_full_int = <0x186a0>;
					front_preview_full_int_cam = <0xa6040>;
					front_preview_full_mif = <0x1b5fd0>;
					front_preview_hpg = <0x1>;
					front_preview_int = <0x186a0>;
					front_preview_int_cam = <0xa1220>;
					front_preview_mif = <0x14a140>;
					front_preview_remosaic_cam = <0xa8750>;
					front_preview_remosaic_hpg = <0x1>;
					front_preview_remosaic_int = <0x186a0>;
					front_preview_remosaic_int_cam = <0xa6040>;
					front_preview_remosaic_mif = <0x1fefc8>;
					front_video_cam = <0xa6040>;
					front_video_capture_cam = <0xa6040>;
					front_video_capture_hpg = <0x1>;
					front_video_capture_int = <0x186a0>;
					front_video_capture_int_cam = <0xa3930>;
					front_video_capture_mif = <0x1b5fd0>;
					front_video_high_speed_120fps_cam = <0xa8750>;
					front_video_high_speed_120fps_hpg = <0x1>;
					front_video_high_speed_120fps_int = <0xa2d78>;
					front_video_high_speed_120fps_int_cam = <0xa8750>;
					front_video_high_speed_120fps_mif = <0x1fefc8>;
					front_video_hpg = <0x1>;
					front_video_int = <0x186a0>;
					front_video_int_cam = <0xa1220>;
					front_video_mif = <0x14a140>;
					front_vt1_cam = <0xa6040>;
					front_vt1_hpg = <0x1>;
					front_vt1_int = <0x186a0>;
					front_vt1_int_cam = <0xa1220>;
					front_vt1_mif = <0xf78f0>;
					front_vt2_cam = <0xa6040>;
					front_vt2_hpg = <0x1>;
					front_vt2_int = <0x186a0>;
					front_vt2_int_cam = <0xa1220>;
					front_vt2_mif = <0xf78f0>;
					front_vt4_cam = <0xa6040>;
					front_vt4_hpg = <0x1>;
					front_vt4_int = <0x186a0>;
					front_vt4_int_cam = <0xa1220>;
					front_vt4_mif = <0xf78f0>;
					max_cam = <0xa8750>;
					max_hpg = <0x1>;
					max_int = <0xa2d78>;
					max_int_cam = <0xa8750>;
					max_mif = <0x1fefc8>;
					preview_high_speed_fps_cam = <0xa6040>;
					preview_high_speed_fps_hpg = <0x1>;
					preview_high_speed_fps_int = <0x186a0>;
					preview_high_speed_fps_int_cam = <0xa6040>;
					preview_high_speed_fps_mif = <0x1fefc8>;
					rear2_capture_cam = <0xa1220>;
					rear2_capture_hpg = <0x1>;
					rear2_capture_int = <0x186a0>;
					rear2_capture_int_cam = <0xa1220>;
					rear2_capture_mif = <0x177bb8>;
					rear2_preview_fhd_cam = <0xa1220>;
					rear2_preview_fhd_hpg = <0x1>;
					rear2_preview_fhd_int = <0x186a0>;
					rear2_preview_fhd_int_cam = <0xa1220>;
					rear2_preview_fhd_mif = <0x14a140>;
					rear3_capture_cam = <0xa3930>;
					rear3_capture_hpg = <0x1>;
					rear3_capture_int = <0x186a0>;
					rear3_capture_int_cam = <0xa3930>;
					rear3_capture_mif = <0x1b5fd0>;
					rear3_preview_cam = <0xa3930>;
					rear3_preview_hpg = <0x1>;
					rear3_preview_int = <0x186a0>;
					rear3_preview_int_cam = <0xa3930>;
					rear3_preview_mif = <0x177bb8>;
					rear3_video_cam = <0xa3930>;
					rear3_video_capture_cam = <0xa3930>;
					rear3_video_capture_hpg = <0x1>;
					rear3_video_capture_int = <0x186a0>;
					rear3_video_capture_int_cam = <0xa3930>;
					rear3_video_capture_mif = <0x1b5fd0>;
					rear3_video_hpg = <0x1>;
					rear3_video_int = <0x186a0>;
					rear3_video_int_cam = <0xa3930>;
					rear3_video_mif = <0x177bb8>;
					rear4_capture_cam = <0xa1220>;
					rear4_capture_hpg = <0x1>;
					rear4_capture_int = <0x186a0>;
					rear4_capture_int_cam = <0xa1220>;
					rear4_capture_mif = <0xf78f0>;
					rear4_preview_cam = <0xa1220>;
					rear4_preview_hpg = <0x1>;
					rear4_preview_int = <0x186a0>;
					rear4_preview_int_cam = <0xa1220>;
					rear4_preview_mif = <0xf78f0>;
					rear_capture_cam = <0xa6040>;
					rear_capture_hpg = <0x1>;
					rear_capture_int = <0x186a0>;
					rear_capture_int_cam = <0xa8750>;
					rear_capture_mif = <0x1fefc8>;
					rear_capture_remosaic_cam = <0xa8750>;
					rear_capture_remosaic_hpg = <0x1>;
					rear_capture_remosaic_int = <0x186a0>;
					rear_capture_remosaic_int_cam = <0xa8750>;
					rear_capture_remosaic_mif = <0x1fefc8>;
					rear_preview_fhd_cam = <0xa6040>;
					rear_preview_fhd_hpg = <0x1>;
					rear_preview_fhd_int = <0x186a0>;
					rear_preview_fhd_int_cam = <0xa6040>;
					rear_preview_fhd_mif = <0x1fefc8>;
					rear_preview_full_cam = <0xa6040>;
					rear_preview_full_hpg = <0x1>;
					rear_preview_full_int = <0x186a0>;
					rear_preview_full_int_cam = <0xa6040>;
					rear_preview_full_mif = <0x1fefc8>;
					rear_preview_hd_cam = <0xa6040>;
					rear_preview_hd_hpg = <0x1>;
					rear_preview_hd_int = <0x186a0>;
					rear_preview_hd_int_cam = <0xa3930>;
					rear_preview_hd_mif = <0x1fefc8>;
					rear_preview_remosaic_cam = <0xa8750>;
					rear_preview_remosaic_hpg = <0x1>;
					rear_preview_remosaic_int = <0x186a0>;
					rear_preview_remosaic_int_cam = <0xa8750>;
					rear_preview_remosaic_mif = <0x1fefc8>;
					rear_preview_uhd_cam = <0xa6040>;
					rear_preview_uhd_hpg = <0x1>;
					rear_preview_uhd_int = <0x82208>;
					rear_preview_uhd_int_cam = <0xa6040>;
					rear_preview_uhd_mif = <0x1fefc8>;
					rear_video_fhd_cam = <0xa6040>;
					rear_video_fhd_capture_cam = <0xa6040>;
					rear_video_fhd_capture_hpg = <0x1>;
					rear_video_fhd_capture_int = <0x186a0>;
					rear_video_fhd_capture_int_cam = <0xa6040>;
					rear_video_fhd_capture_mif = <0x1b5fd0>;
					rear_video_fhd_hpg = <0x1>;
					rear_video_fhd_int = <0x186a0>;
					rear_video_fhd_int_cam = <0xa3930>;
					rear_video_fhd_mif = <0x177bb8>;
					rear_video_hd_cam = <0xa6040>;
					rear_video_hd_capture_cam = <0xa6040>;
					rear_video_hd_capture_hpg = <0x1>;
					rear_video_hd_capture_int = <0x186a0>;
					rear_video_hd_capture_int_cam = <0xa3930>;
					rear_video_hd_capture_mif = <0x177bb8>;
					rear_video_hd_hpg = <0x1>;
					rear_video_hd_int = <0x186a0>;
					rear_video_hd_int_cam = <0xa6040>;
					rear_video_hd_mif = <0x177bb8>;
					rear_video_uhd_cam = <0xa6040>;
					rear_video_uhd_capture_cam = <0xa6040>;
					rear_video_uhd_capture_hpg = <0x1>;
					rear_video_uhd_capture_int = <0x186a0>;
					rear_video_uhd_capture_int_cam = <0xa6040>;
					rear_video_uhd_capture_mif = <0x1b5fd0>;
					rear_video_uhd_hpg = <0x1>;
					rear_video_uhd_int = <0x186a0>;
					rear_video_uhd_int_cam = <0xa3930>;
					rear_video_uhd_mif = <0x177bb8>;
					video_high_speed_120fps_cam = <0xa6040>;
					video_high_speed_120fps_hpg = <0x1>;
					video_high_speed_120fps_int = <0x186a0>;
					video_high_speed_120fps_int_cam = <0xa6040>;
					video_high_speed_120fps_mif = <0x1fefc8>;
					video_high_speed_240fps_cam = <0xa6040>;
					video_high_speed_240fps_hpg = <0x8>;
					video_high_speed_240fps_int = <0x186a0>;
					video_high_speed_240fps_int_cam = <0xa6040>;
					video_high_speed_240fps_mif = <0x1fefc8>;
					video_high_speed_480fps_cam = <0xa8750>;
					video_high_speed_480fps_hpg = <0x1>;
					video_high_speed_480fps_int = <0xa2d78>;
					video_high_speed_480fps_int_cam = <0xa8750>;
					video_high_speed_480fps_mif = <0x1fefc8>;
					video_high_speed_60fps_cam = <0xa6040>;
					video_high_speed_60fps_capture_cam = <0xa8750>;
					video_high_speed_60fps_capture_hpg = <0x1>;
					video_high_speed_60fps_capture_int = <0x186a0>;
					video_high_speed_60fps_capture_int_cam = <0xa8750>;
					video_high_speed_60fps_capture_mif = <0x1fefc8>;
					video_high_speed_60fps_hpg = <0x1>;
					video_high_speed_60fps_int = <0x186a0>;
					video_high_speed_60fps_int_cam = <0xa6040>;
					video_high_speed_60fps_mif = <0x1fefc8>;
				};
			};

			vender {
				check_sensor_vendor;
				front_sensor_id = <0x79>;
				max_camera_num = <0x5>;
				max_supported_camera = <0x6>;
				need_i2c_config;
				rear2_sensor_id = <0xd2>;
				rear3_sensor_id = <0xd3>;
				rear4_sensor_id = <0xd2>;
				rear_sensor_id = <0x78>;
				supported_cameraId = <0x0 0x1 0x17 0x32 0x34 0x36>;
				use_module_check;

				camera_info0 {
					cal_memory = <0x2>;
					companion = <0x0>;
					core_voltage = <0x0>;
					dual_open = <0x0>;
					isp = <0x0>;
					ois = <0x0>;
					position = <0x0>;
					read_version = <0x0>;
					upgrade = <0x0>;
					valid = <0x1>;
				};

				camera_info1 {
					cal_memory = <0x2>;
					companion = <0x0>;
					core_voltage = <0x0>;
					dual_open = <0x0>;
					isp = <0x0>;
					ois = <0x0>;
					position = <0x1>;
					read_version = <0x0>;
					upgrade = <0x0>;
					valid = <0x1>;
				};

				camera_info2 {
					cal_memory = <0x2>;
					companion = <0x0>;
					core_voltage = <0x0>;
					dual_open = <0x1>;
					isp = <0x0>;
					ois = <0x0>;
					position = <0x2>;
					read_version = <0x0>;
					upgrade = <0x0>;
					valid = <0x1>;
				};

				camera_info3 {
					cal_memory = <0x2>;
					companion = <0x0>;
					core_voltage = <0x0>;
					dual_open = <0x0>;
					isp = <0x0>;
					ois = <0x0>;
					position = <0x4>;
					read_version = <0x0>;
					upgrade = <0x0>;
					valid = <0x1>;
				};

				camera_info4 {
					cal_memory = <0x2>;
					companion = <0x0>;
					core_voltage = <0x0>;
					dual_open = <0x0>;
					isp = <0x0>;
					ois = <0x0>;
					position = <0x6>;
					read_version = <0x0>;
					upgrade = <0x0>;
					valid = <0x1>;
				};
			};
		};
	};

	fragment@20 {
		target = <0xffffffff>;

		__overlay__ {
			status = "okay";

			dwc3 {
				dr_mode = "otg";
				maximum-speed = "high-speed";
			};
		};
	};

	fragment@21 {
		target = <0xffffffff>;

		__overlay__ {
			dr_mode = "otg";
			ldo-names = "vdd_ldo12", "vdd_ldo13", "vdd_ldo14";
			maximum-speed = "high-speed";
		};
	};

	fragment@22 {
		target = <0xffffffff>;

		__overlay__ {
			hs_tune_param = <0x20>;
			status = "okay";
			usb3phy-isolation = <0x1>;
		};
	};

	fragment@23 {
		target = <0xffffffff>;

		__overlay__ {
			hs_tune_param = <0x21>;
			ss_tune_param = <0x22>;
			status = "okay";
			usb3phy-isolation = <0x1>;
		};
	};

	fragment@24 {
		target = <0xffffffff>;

		__overlay__ {
			samsung,uart-logging;
			status = "okay";
		};
	};

	fragment@25 {
		target = <0xffffffff>;

		__overlay__ {

			attn-input {
				linux,phandle = <0x12>;
				phandle = <0x12>;
				samsung,pin-function = <0x0>;
				samsung,pin-pud = <0x1>;
				samsung,pins = "gpa0-0";
			};

			attn-irq {
				linux,phandle = <0x11>;
				phandle = <0x11>;
				samsung,pin-drv = <0x0>;
				samsung,pin-function = <0xf>;
				samsung,pin-pud = <0x0>;
				samsung,pins = "gpa0-0";
			};

			certify-hall-irq {
				linux,phandle = <0x15>;
				phandle = <0x15>;
				samsung,pin-drv = <0x0>;
				samsung,pin-function = <0xf>;
				samsung,pin-pud = <0x0>;
				samsung,pins = "gpa0-2";
			};

			codec_irq {
				linux,phandle = <0x7>;
				phandle = <0x7>;
				samsung,pin-function = <0xf>;
				samsung,pin-pud = <0x0>;
				samsung,pins = "gpa1-2";
			};

			dwmmc2_cd_ext_irq {
				linux,phandle = <0x13>;
				phandle = <0x13>;
				samsung,pin-drv = <0x3>;
				samsung,pin-function = <0xf>;
				samsung,pin-pud = <0x0>;
				samsung,pins = "gpa2-4";
			};

			hall-irq {
				linux,phandle = <0x14>;
				phandle = <0x14>;
				samsung,pin-drv = <0x0>;
				samsung,pin-function = <0xf>;
				samsung,pin-pud = <0x0>;
				samsung,pins = "gpa0-3";
			};

			if-pmic-irq {
				linux,phandle = <0x25>;
				phandle = <0x25>;
				samsung,pin-drv = <0x0>;
				samsung,pin-function = <0x0>;
				samsung,pin-pud = <0x0>;
				samsung,pins = "gpa2-2";
			};

			key-power {
				linux,phandle = <0x10>;
				phandle = <0x10>;
				samsung,pin-drv = <0x0>;
				samsung,pin-function = <0xf>;
				samsung,pin-pud = <0x0>;
				samsung,pins = "gpa1-7";
			};

			key-voldown {
				linux,phandle = <0xe>;
				phandle = <0xe>;
				samsung,pin-drv = <0x0>;
				samsung,pin-function = <0xf>;
				samsung,pin-pud = <0x0>;
				samsung,pins = "gpa1-6";
			};

			key-volup {
				linux,phandle = <0xf>;
				phandle = <0xf>;
				samsung,pin-drv = <0x0>;
				samsung,pin-function = <0xf>;
				samsung,pin-pud = <0x0>;
				samsung,pins = "gpa1-5";
			};

			pmic-irq {
				linux,phandle = <0xb>;
				phandle = <0xb>;
				samsung,pin-drv = <0x3>;
				samsung,pin-pud = <0x3>;
				samsung,pins = "gpa2-0";
			};

			usbpd-irq {
				linux,phandle = <0x23>;
				phandle = <0x23>;
				samsung,pin-drv = <0x0>;
				samsung,pin-function = <0xf>;
				samsung,pin-pud = <0x0>;
				samsung,pins = "gpa2-3";
			};
		};
	};

	fragment@26 {
		target = <0xffffffff>;

		__overlay__ {

			motor-en {
				linux,phandle = <0x16>;
				phandle = <0x16>;
				samsung,pin-con-pdn = <0x3>;
				samsung,pin-function = <0x1>;
				samsung,pin-pud = <0x0>;
				samsung,pin-pud-pdn = <0x0>;
				samsung,pin-val = <0x0>;
				samsung,pins = "gpg2-5";
			};

			pm-wrsti {
				linux,phandle = <0xc>;
				phandle = <0xc>;
				samsung,pin-con-pdn = <0x3>;
				samsung,pins = "gpg0-7";
			};
		};
	};

	fragment@27 {
		target = <0xffffffff>;

		__overlay__ {
			exynos,block-type = "sda";
			exynos,fips-block_offset = <0x5>;
		};
	};

	fragment@28 {
		target = <0xffffffff>;

		__overlay__ {
			status = "disabled";
		};
	};

	fragment@29 {
		target = <0xffffffff>;

		__overlay__ {
			status = "disabled";
		};
	};

	fragment@3 {
		target = <0xffffffff>;

		__overlay__ {
			#address-cells = <0x1>;
			#size-cells = <0x0>;
			clock-frequency = <0xf4240>;
			gpios = <0xffffffff 0x0 0x0 0xffffffff 0x1 0x0>;
			pinctrl-0 = <0xffffffff>;
			pinctrl-1 = <0xffffffff>;
			pinctrl-2 = <0xffffffff>;
			pinctrl-names = "default", "on_i2c", "off_i2c";
			samsung,fast-plus-mode;
			samsung,reset-before-trans;
			status = "okay";

			fimc-is-imx616@1A {
				compatible = "samsung,exynos5-fimc-is-cis-imx616";
				id = <0x1>;
				reg = <0x1a>;
				sensor_f_number = <0xdc>;
				setfile = "setB";
				use_3hdr;
				use_initial_ae;
			};
		};
	};

	fragment@30 {
		target = <0xffffffff>;

		__overlay__ {
			status = "okay";
			usi_v2_mode = "spi";
		};
	};

	fragment@31 {
		target = <0xffffffff>;

		__overlay__ {
			status = "disabled";
		};
	};

	fragment@32 {
		target = <0xffffffff>;

		__overlay__ {
			status = "disabled";
		};
	};

	fragment@33 {
		target = <0xffffffff>;

		__overlay__ {
			status = "okay";
			usi_v2_mode = "i2c";
		};
	};

	fragment@34 {
		target = <0xffffffff>;

		__overlay__ {
			status = "okay";
			usi_v2_mode = "i2c";
		};
	};

	fragment@35 {
		target = <0xffffffff>;

		__overlay__ {
			status = "disabled";
		};
	};

	fragment@36 {
		target = <0xffffffff>;

		__overlay__ {
			status = "okay";
			usi_v2_mode = "i2c";
		};
	};

	fragment@37 {
		target = <0xffffffff>;

		__overlay__ {
			status = "disabled";
		};
	};

	fragment@38 {
		target = <0xffffffff>;

		__overlay__ {
			status = "okay";
			usi_v2_mode = "spi";
		};
	};

	fragment@39 {
		target = <0xffffffff>;

		__overlay__ {
			status = "disabled";
		};
	};

	fragment@4 {
		target = <0xffffffff>;

		__overlay__ {
			#address-cells = <0x1>;
			#size-cells = <0x0>;
			clock-frequency = <0xf4240>;
			gpios = <0xffffffff 0x2 0x0 0xffffffff 0x3 0x0>;
			pinctrl-0 = <0xffffffff>;
			pinctrl-1 = <0xffffffff>;
			pinctrl-2 = <0xffffffff>;
			pinctrl-names = "default", "on_i2c", "off_i2c";
			samsung,fast-plus-mode;
			samsung,reset-before-trans;
			status = "okay";

			fimc-is-imx582@1A {
				compatible = "samsung,exynos5-fimc-is-cis-imx582";
				id = <0x0>;
				reg = <0x1a>;
				sensor_f_number = <0xc8>;
				setfile = "setB";
			};
		};
	};

	fragment@40 {
		target = <0xffffffff>;

		__overlay__ {
			status = "okay";
			usi_v2_mode = "i2c";
		};
	};

	fragment@41 {
		target = <0xffffffff>;

		__overlay__ {
			status = "disabled";
		};
	};

	fragment@42 {
		target = <0xffffffff>;

		__overlay__ {
			status = "okay";
			usi_v2_mode = "spi";
		};
	};

	fragment@43 {
		target = <0xffffffff>;

		__overlay__ {
			bootargs_ext = "root=/dev/ram0 androidboot.boot_devices=13520000.ufs";
		};
	};

	fragment@44 {
		target = <0xffffffff>;

		__overlay__ {
			#address-cells = <0x1>;
			#size-cells = <0x0>;
			i2c-gpio,delay-us = <0x5>;
			samsung,fix-doxfer-return;
			samsung,glitch-filter;
			samsung,i2c-max-bus-freq = <0x61a80>;
			status = "okay";

			usbpd-5713@33 {
				compatible = "sm5713-usbpd,i2c";
				linux,phandle = <0x6f>;
				phandle = <0x6f>;
				pinctrl-0 = <0x23>;
				pinctrl-names = "default";
				reg = <0x33>;
				support_pd_role_swap;
				usbpd,usbpd_int = <0xffffffff 0x3 0x0>;
			};
		};
	};

	fragment@45 {
		target = <0xffffffff>;

		__overlay__ {
			#address-cells = <0x1>;
			#size-cells = <0x0>;
			samsung,fix-doxfer-return;
			samsung,glitch-filter;
			samsung,i2c-max-bus-freq = <0x61a80>;
			status = "okay";

			sm5713@49 {
				compatible = "siliconmitus,sm5713mfd";
				pinctrl-0 = <0x24 0x25>;
				pinctrl-names = "default";
				reg = <0x49>;
				sm5713,irq-gpio = <0xffffffff 0x2 0x0>;
				sm5713,wakeup;
			};
		};
	};

	fragment@46 {
		target = <0xffffffff>;

		__overlay__ {
			#address-cells = <0x1>;
			#size-cells = <0x0>;
			status = "okay";

			s2mpb03@56 {
				compatible = "samsung,s2mpb03pmic";
				reg = <0x56>;
				s2mpb03,wakeup;

				regulators {

					s2mpb03-ldo1 {
						linux,phandle = <0x70>;
						phandle = <0x70>;
						regulator-max-microvolt = <0x10c8e0>;
						regulator-min-microvolt = <0x10c8e0>;
						regulator-name = "CAM_VLDO1";
					};

					s2mpb03-ldo2 {
						linux,phandle = <0x71>;
						phandle = <0x71>;
						regulator-max-microvolt = <0x100590>;
						regulator-min-microvolt = <0x100590>;
						regulator-name = "CAM_VLDO2";
					};

					s2mpb03-ldo3 {
						linux,phandle = <0x72>;
						phandle = <0x72>;
						regulator-max-microvolt = <0x1b7740>;
						regulator-min-microvolt = <0x1b7740>;
						regulator-name = "CAM_VLDO3";
					};

					s2mpb03-ldo4 {
						linux,phandle = <0x73>;
						phandle = <0x73>;
						regulator-max-microvolt = <0x10c8e0>;
						regulator-min-microvolt = <0x10c8e0>;
						regulator-name = "CAM_VLDO4";
					};

					s2mpb03-ldo5 {
						linux,phandle = <0x74>;
						phandle = <0x74>;
						regulator-max-microvolt = <0x2c4020>;
						regulator-min-microvolt = <0x2c4020>;
						regulator-name = "CAM_VLDO5";
					};

					s2mpb03-ldo6 {
						linux,phandle = <0x75>;
						phandle = <0x75>;
						regulator-max-microvolt = <0x2c4020>;
						regulator-min-microvolt = <0x2c4020>;
						regulator-name = "CAM_VLDO6";
					};

					s2mpb03-ldo7 {
						linux,phandle = <0x76>;
						phandle = <0x76>;
						regulator-max-microvolt = <0x2ab980>;
						regulator-min-microvolt = <0x2ab980>;
						regulator-name = "CAM_VLDO7";
					};
				};
			};
		};
	};

	fragment@47 {
		target = <0xffffffff>;

		__overlay__ {

			camera_contig {
				compatible = "exynos9820-ion";
				ion,heapname = "camera_heap";
				ion,protection_id = <0xa>;
				ion,secure;
				reg = <0x0 0xdb900000 0x700000>;
			};

			secure_camera {
				compatible = "exynos9820-ion";
				ion,alignment = <0x10000>;
				ion,heapname = "secure_camera_heap";
				ion,protection_id = <0xb>;
				ion,secure;
				reg = <0x0 0xe1900000 0x2000000>;
			};
		};
	};

	fragment@48 {
		target = <0xffffffff>;

		__overlay__ {

			chg-en {
				linux,phandle = <0x24>;
				phandle = <0x24>;
				samsung,pin-drv = <0x0>;
				samsung,pin-function = <0x1>;
				samsung,pin-pud = <0x1>;
				samsung,pins = "gpg2-3";
			};
		};
	};

	fragment@49 {
		target = <0xffffffff>;

		__overlay__ {

			btp-rst {
				linux,phandle = <0x17>;
				phandle = <0x17>;
				samsung,pin-drv = <0x0>;
				samsung,pin-function = <0x1>;
				samsung,pin-pud = <0x1>;
				samsung,pins = "gpg3-0";
			};

			spi17-miso-inactive {
				linux,phandle = <0x1d>;
				phandle = <0x1d>;
				samsung,pin-drv = <0x2>;
				samsung,pin-function = <0x0>;
				samsung,pin-pud = <0x1>;
				samsung,pins = "gpp2-6";
			};

			spi7-bus-inactive {
				linux,phandle = <0x1c>;
				phandle = <0x1c>;
				samsung,pin-drv = <0x2>;
				samsung,pin-function = <0x1>;
				samsung,pin-pud = <0x0>;
				samsung,pin-val = <0x0>;
				samsung,pins = "gpp2-4", "gpp2-5", "gpp2-7";
			};

			spi7-clk {
				linux,phandle = <0x18>;
				phandle = <0x18>;
				samsung,pin-drv = <0x2>;
				samsung,pin-function = <0x2>;
				samsung,pin-pud = <0x1>;
				samsung,pins = "gpp2-4";
			};

			spi7-cs {
				linux,phandle = <0x19>;
				phandle = <0x19>;
				samsung,pin-drv = <0x2>;
				samsung,pin-function = <0x2>;
				samsung,pin-pud = <0x3>;
				samsung,pins = "gpp2-7";
			};

			spi7-miso {
				linux,phandle = <0x1a>;
				phandle = <0x1a>;
				samsung,pin-drv = <0x2>;
				samsung,pin-function = <0x2>;
				samsung,pin-pud = <0x1>;
				samsung,pins = "gpp2-6";
			};

			spi7-mosi {
				linux,phandle = <0x1b>;
				phandle = <0x1b>;
				samsung,pin-drv = <0x2>;
				samsung,pin-function = <0x2>;
				samsung,pin-pud = <0x1>;
				samsung,pins = "gpp2-5";
			};
		};
	};

	fragment@5 {
		target = <0xffffffff>;

		__overlay__ {
			#address-cells = <0x1>;
			#size-cells = <0x0>;
			clock-frequency = <0x61a80>;
			gpios = <0xffffffff 0x4 0x0 0xffffffff 0x5 0x0>;
			pinctrl-0 = <0xffffffff>;
			pinctrl-1 = <0xffffffff>;
			pinctrl-2 = <0xffffffff>;
			pinctrl-names = "default", "on_i2c", "off_i2c";
			samsung,reset-before-trans;
			status = "okay";

			fimc-is-gc5035@6E {
				compatible = "samsung,exynos5-fimc-is-cis-gc5035";
				id = <0x2>;
				reg = <0x37>;
				sensor_bayer_order = <0x0>;
				sensor_f_number = <0xdc>;
				setfile = "setB";
				use_initial_ae;
			};
		};
	};

	fragment@50 {
		target = <0xffffffff>;

		__overlay__ {
			chub-irq-pin;
			chub-irq-pin-len = <0x0>;
			clock-names = "chub_bus", "cmgp_i2c";
			clocks = <0xffffffff 0x258 0xffffffff 0x7d>;
			mag-check-mst = <0xffffffff 0x1 0x0>;
			mag-check-nfc = <0xffffffff 0x3 0x0>;
			os-type = "sensorhub/a51_bring_up.fw";
			sensor-ldo-en = <0xffffffff 0x0 0x1>;
			ssp-acc-position = <0x4>;
			ssp-light-cam-br = <0x3c 0x3c>;
			ssp-light-cam-lux = <0x64 0xc8>;
			ssp-light-position = <0x33 0x51 0x2 0x3b 0x1 0x8>;
			ssp-mag-array = [00 00 00 00 00 00 00 00 00 00 00 00 00 00 00 00 00 00 00 00 00 00 00 00 00 00 00];
			ssp-mag-mst-array = [90 59 e5 6f b2 93 01 8b ce 36 ba d8 8c b3 ff b3 00 ee a6 79 bc ff 1e c1 09 05 57];
			ssp-mag-position = <0x2>;
			ssp-prox-thresh-addval = [00 50 00 14 00 1e];
		};
	};

	fragment@51 {
		target = <0xffffffff>;

		__overlay__ {

			nfc_clk_req {
				linux,phandle = <0x29>;
				phandle = <0x29>;
				samsung,pin-pud = <0x0>;
				samsung,pins = "gpa2-6";
			};

			nfc_clk_req_nc {
				linux,phandle = <0x2d>;
				phandle = <0x2d>;
				samsung,pin-function = <0x0>;
				samsung,pin-pud = <0x1>;
				samsung,pins = "gpa2-6";
			};

			xclkout1_nc {
				linux,phandle = <0x2e>;
				phandle = <0x2e>;
				samsung,pin-function = <0x0>;
				samsung,pin-pud = <0x1>;
				samsung,pins = "gpq0-0";
			};
		};
	};

	fragment@52 {
		target = <0xffffffff>;

		__overlay__ {

			nfc-check {
				linux,phandle = <0x2a>;
				phandle = <0x2a>;
				samsung,pin-function = <0x0>;
				samsung,pin-pud = <0x0>;
				samsung,pin-pud-pdn = <0x0>;
				samsung,pins = "gpg0-3";
			};

			nfc_en {
				linux,phandle = <0x26>;
				phandle = <0x26>;
				samsung,pin-con-pdn = <0x3>;
				samsung,pin-drv = <0x0>;
				samsung,pin-function = <0x0>;
				samsung,pin-pud = <0x0>;
				samsung,pin-pud-pdn = <0x0>;
				samsung,pins = "gpg0-0";
			};

			nfc_en_nc {
				linux,phandle = <0x2b>;
				phandle = <0x2b>;
				samsung,pin-con-pdn = <0x2>;
				samsung,pin-function = <0x0>;
				samsung,pin-pud = <0x1>;
				samsung,pin-pud-pdn = <0x1>;
				samsung,pins = "gpg0-0";
			};

			nfc_firm {
				linux,phandle = <0x27>;
				phandle = <0x27>;
				samsung,pin-con-pdn = <0x3>;
				samsung,pin-function = <0x1>;
				samsung,pin-pud = <0x0>;
				samsung,pin-pud-pdn = <0x0>;
				samsung,pin-val = <0x0>;
				samsung,pins = "gpg1-0";
			};

			nfc_firm_nc {
				linux,phandle = <0x2c>;
				phandle = <0x2c>;
				samsung,pin-con-pdn = <0x2>;
				samsung,pin-function = <0x0>;
				samsung,pin-pud = <0x1>;
				samsung,pin-pud-pdn = <0x1>;
				samsung,pins = "gpg1-0";
			};

			nfc_pwr_en {
				linux,phandle = <0x77>;
				phandle = <0x77>;
				samsung,pin-con-pdn = <0x3>;
				samsung,pin-function = <0x1>;
				samsung,pin-pud = <0x0>;
				samsung,pin-pud-pdn = <0x0>;
				samsung,pin-val = <0x0>;
				samsung,pins = "gpg2-0";
			};

			nfc_pwr_en_nc {
				linux,phandle = <0x28>;
				phandle = <0x28>;
				samsung,pin-con-pdn = <0x2>;
				samsung,pin-function = <0x0>;
				samsung,pin-pud = <0x1>;
				samsung,pin-pud-pdn = <0x1>;
				samsung,pins = "gpg2-0";
			};
		};
	};

	fragment@53 {
		target = <0xffffffff>;

		__overlay__ {
			#address-cells = <0x1>;
			#size-cells = <0x0>;
			clock-frequency = <0x61a80>;
			samsung,reset-before-trans;
			status = "okay";

			pn547@2B {
				clkctrl-reg = <0x11860a0c>;
				clock-names = "oscclk_nfc";
				clocks = <0xffffffff 0x320>;
				compatible = "pn547";
				interrupt-parent = <0xffffffff>;
				interrupts = <0x0 0x0 0x0>;
				pinctrl-0 = <0x26 0x27 0x28 0xffffffff 0x29 0x2a>;
				pinctrl-1 = <0x2b 0x2c 0x28 0x2d 0x2e>;
				pinctrl-names = "default", "nfc_nc";
				pn547,check_nfc = <0xffffffff 0x3 0x0>;
				pn547,clk_req-gpio = <0xffffffff 0x6 0x0>;
				pn547,firm-gpio = <0xffffffff 0x0 0x1>;
				pn547,irq-gpio = <0xffffffff 0x0 0x0>;
				pn547,ldo_control;
				pn547,nfc_ap_clk;
				pn547,nfc_pvdd = "vdd_ldo33";
				pn547,ven-gpio = <0xffffffff 0x0 0x0>;
				reg = <0x2b>;
			};
		};
	};

	fragment@54 {
		target = <0xffffffff>;

		__overlay__ {
			pinctrl-0 = <0x2f>;
			pinctrl-names = "default";

			initial-state {
				linux,phandle = <0x2f>;
				phandle = <0x2f>;

				gpa0-6 {
					samsung,pin-function = <0x0>;
					samsung,pin-pud = <0x1>;
					samsung,pins = "gpa0-6";
				};
			};
		};
	};

	fragment@55 {
		target = <0xffffffff>;

		__overlay__ {
			pinctrl-0 = <0x30>;
			pinctrl-names = "default";

			initial-state {
				linux,phandle = <0x30>;
				phandle = <0x30>;

				gpm0-0 {
					samsung,pin-function = <0x0>;
					samsung,pin-pud = <0x1>;
					samsung,pins = "gpm0-0";
				};
			};
		};
	};

	fragment@56 {
		target = <0xffffffff>;

		__overlay__ {
			pinctrl-0 = <0x31>;
			pinctrl-names = "sleep";

			sleep-state {
				linux,phandle = <0x31>;
				phandle = <0x31>;

				gpb2-0 {
					samsung,pin-con-pdn = <0x2>;
					samsung,pin-pud-pdn = <0x1>;
					samsung,pins = "gpb2-0";
				};

				gpb2-1 {
					samsung,pin-con-pdn = <0x2>;
					samsung,pin-pud-pdn = <0x1>;
					samsung,pins = "gpb2-1";
				};

				gpb2-2 {
					samsung,pin-con-pdn = <0x2>;
					samsung,pin-pud-pdn = <0x1>;
					samsung,pins = "gpb2-2";
				};

				gpb2-3 {
					samsung,pin-con-pdn = <0x2>;
					samsung,pin-pud-pdn = <0x1>;
					samsung,pins = "gpb2-3";
				};

				gpb2-4 {
					samsung,pin-con-pdn = <0x2>;
					samsung,pin-pud-pdn = <0x1>;
					samsung,pins = "gpb2-4";
				};
			};
		};
	};

	fragment@57 {
		target = <0xffffffff>;

		__overlay__ {
			pinctrl-0 = <0x32>;
			pinctrl-1 = <0x33>;
			pinctrl-names = "default", "sleep";

			initial-state {
				linux,phandle = <0x32>;
				phandle = <0x32>;

				gpc2-4 {
					samsung,pin-function = <0x0>;
					samsung,pin-pud = <0x1>;
					samsung,pins = "gpc2-4";
				};

				gpg0-1 {
					samsung,pin-function = <0x0>;
					samsung,pin-pud = <0x0>;
					samsung,pins = "gpg0-1";
				};

				gpg0-4 {
					samsung,pin-function = <0x0>;
					samsung,pin-pud = <0x0>;
					samsung,pins = "gpg0-4";
				};

				gpg0-7 {
					samsung,pin-function = <0x0>;
					samsung,pin-pud = <0x1>;
					samsung,pins = "gpg0-7";
				};

				gpg1-4 {
					samsung,pin-function = <0x0>;
					samsung,pin-pud = <0x1>;
					samsung,pins = "gpg1-4";
				};

				gpg1-5 {
					samsung,pin-drv = <0x0>;
					samsung,pin-function = <0x1>;
					samsung,pin-pud = <0x0>;
					samsung,pin-val = <0x1>;
					samsung,pins = "gpg1-5";
				};

				gpg1-6 {
					samsung,pin-drv = <0x0>;
					samsung,pin-function = <0x1>;
					samsung,pin-pud = <0x0>;
					samsung,pin-val = <0x0>;
					samsung,pins = "gpg1-6";
				};

				gpg2-1 {
					samsung,pin-drv = <0x0>;
					samsung,pin-function = <0x1>;
					samsung,pin-pud = <0x0>;
					samsung,pin-val = <0x1>;
					samsung,pins = "gpg2-1";
				};

				gpg2-2 {
					samsung,pin-function = <0x0>;
					samsung,pin-pud = <0x0>;
					samsung,pins = "gpg2-2";
				};

				gpg3-1 {
					samsung,pin-drv = <0x0>;
					samsung,pin-function = <0x1>;
					samsung,pin-pud = <0x0>;
					samsung,pin-val = <0x1>;
					samsung,pins = "gpg3-1";
				};

				gpg3-2 {
					samsung,pin-function = <0x0>;
					samsung,pin-pud = <0x0>;
					samsung,pins = "gpg3-2";
				};

				gpg3-3 {
					samsung,pin-function = <0x0>;
					samsung,pin-pud = <0x0>;
					samsung,pins = "gpg3-3";
				};

				gpg3-4 {
					samsung,pin-function = <0x0>;
					samsung,pin-pud = <0x0>;
					samsung,pins = "gpg3-4";
				};

				gpg3-5 {
					samsung,pin-function = <0x0>;
					samsung,pin-pud = <0x0>;
					samsung,pins = "gpg3-5";
				};

				gpp0-4 {
					samsung,pin-function = <0x0>;
					samsung,pin-pud = <0x0>;
					samsung,pins = "gpp0-4";
				};

				gpp0-5 {
					samsung,pin-function = <0x0>;
					samsung,pin-pud = <0x0>;
					samsung,pins = "gpp0-5";
				};
			};

			sleep-state {
				linux,phandle = <0x33>;
				phandle = <0x33>;

				gpc1-2 {
					samsung,pin-con-pdn = <0x2>;
					samsung,pin-pud-pdn = <0x1>;
					samsung,pins = "gpc1-2";
				};

				gpc1-3 {
					samsung,pin-con-pdn = <0x2>;
					samsung,pin-pud-pdn = <0x1>;
					samsung,pins = "gpc1-3";
				};

				gpc2-2 {
					samsung,pin-con-pdn = <0x2>;
					samsung,pin-pud-pdn = <0x1>;
					samsung,pins = "gpc2-2";
				};

				gpc2-4 {
					samsung,pin-con-pdn = <0x2>;
					samsung,pin-pud-pdn = <0x1>;
					samsung,pins = "gpc2-4";
				};

				gpg0-1 {
					samsung,pin-con-pdn = <0x2>;
					samsung,pin-pud-pdn = <0x0>;
					samsung,pins = "gpg0-1";
				};

				gpg0-4 {
					samsung,pin-con-pdn = <0x2>;
					samsung,pin-pud-pdn = <0x0>;
					samsung,pins = "gpg0-4";
				};

				gpg0-5 {
					samsung,pin-con-pdn = <0x3>;
					samsung,pin-pud-pdn = <0x0>;
					samsung,pins = "gpg0-5";
				};

				gpg0-6 {
					samsung,pin-con-pdn = <0x0>;
					samsung,pin-pud-pdn = <0x1>;
					samsung,pins = "gpg0-6";
				};

				gpg0-7 {
					samsung,pin-con-pdn = <0x2>;
					samsung,pin-pud-pdn = <0x1>;
					samsung,pins = "gpg0-7";
				};

				gpg1-2 {
					samsung,pin-con-pdn = <0x3>;
					samsung,pin-pud-pdn = <0x0>;
					samsung,pins = "gpg1-2";
				};

				gpg1-3 {
					samsung,pin-con-pdn = <0x3>;
					samsung,pin-pud-pdn = <0x0>;
					samsung,pins = "gpg1-3";
				};

				gpg1-4 {
					samsung,pin-con-pdn = <0x2>;
					samsung,pin-pud-pdn = <0x1>;
					samsung,pins = "gpg1-4";
				};

				gpg1-5 {
					samsung,pin-con-pdn = <0x1>;
					samsung,pin-pud-pdn = <0x0>;
					samsung,pins = "gpg1-5";
				};

				gpg1-6 {
					samsung,pin-con-pdn = <0x0>;
					samsung,pin-pud-pdn = <0x1>;
					samsung,pins = "gpg1-6";
				};

				gpg2-1 {
					samsung,pin-con-pdn = <0x3>;
					samsung,pin-pud-pdn = <0x0>;
					samsung,pins = "gpg2-1";
				};

				gpg2-2 {
					samsung,pin-con-pdn = <0x2>;
					samsung,pin-pud-pdn = <0x0>;
					samsung,pins = "gpg2-2";
				};

				gpg2-3 {
					samsung,pin-con-pdn = <0x3>;
					samsung,pin-pud-pdn = <0x1>;
					samsung,pins = "gpg2-3";
				};

				gpg2-4 {
					samsung,pin-con-pdn = <0x3>;
					samsung,pin-pud-pdn = <0x0>;
					samsung,pins = "gpg2-4";
				};

				gpg3-0 {
					samsung,pin-con-pdn = <0x0>;
					samsung,pin-pud-pdn = <0x1>;
					samsung,pins = "gpg3-0";
				};

				gpg3-1 {
					samsung,pin-con-pdn = <0x3>;
					samsung,pin-pud-pdn = <0x0>;
					samsung,pins = "gpg3-1";
				};

				gpg3-2 {
					samsung,pin-con-pdn = <0x2>;
					samsung,pin-pud-pdn = <0x0>;
					samsung,pins = "gpg3-2";
				};

				gpg3-3 {
					samsung,pin-con-pdn = <0x2>;
					samsung,pin-pud-pdn = <0x0>;
					samsung,pins = "gpg3-3";
				};

				gpg3-4 {
					samsung,pin-con-pdn = <0x2>;
					samsung,pin-pud-pdn = <0x0>;
					samsung,pins = "gpg3-4";
				};

				gpg3-5 {
					samsung,pin-con-pdn = <0x2>;
					samsung,pin-pud-pdn = <0x0>;
					samsung,pins = "gpg3-5";
				};

				gpg4-0 {
					samsung,pin-con-pdn = <0x3>;
					samsung,pin-pud-pdn = <0x0>;
					samsung,pins = "gpg4-0";
				};

				gpg4-2 {
					samsung,pin-con-pdn = <0x3>;
					samsung,pin-pud-pdn = <0x0>;
					samsung,pins = "gpg4-2";
				};

				gpp0-0 {
					samsung,pin-con-pdn = <0x2>;
					samsung,pin-pud-pdn = <0x0>;
					samsung,pins = "gpp0-0";
				};

				gpp0-1 {
					samsung,pin-con-pdn = <0x2>;
					samsung,pin-pud-pdn = <0x0>;
					samsung,pins = "gpp0-1";
				};

				gpp0-2 {
					samsung,pin-con-pdn = <0x2>;
					samsung,pin-pud-pdn = <0x0>;
					samsung,pins = "gpp0-2";
				};

				gpp0-3 {
					samsung,pin-con-pdn = <0x2>;
					samsung,pin-pud-pdn = <0x0>;
					samsung,pins = "gpp0-3";
				};

				gpp0-4 {
					samsung,pin-con-pdn = <0x2>;
					samsung,pin-pud-pdn = <0x0>;
					samsung,pins = "gpp0-4";
				};

				gpp0-5 {
					samsung,pin-con-pdn = <0x2>;
					samsung,pin-pud-pdn = <0x0>;
					samsung,pins = "gpp0-5";
				};

				gpp0-6 {
					samsung,pin-con-pdn = <0x2>;
					samsung,pin-pud-pdn = <0x0>;
					samsung,pins = "gpp0-6";
				};

				gpp0-7 {
					samsung,pin-con-pdn = <0x2>;
					samsung,pin-pud-pdn = <0x0>;
					samsung,pins = "gpp0-7";
				};

				gpp1-0 {
					samsung,pin-con-pdn = <0x2>;
					samsung,pin-pud-pdn = <0x0>;
					samsung,pins = "gpp1-0";
				};

				gpp1-1 {
					samsung,pin-con-pdn = <0x2>;
					samsung,pin-pud-pdn = <0x0>;
					samsung,pins = "gpp1-1";
				};

				gpp1-2 {
					samsung,pin-con-pdn = <0x2>;
					samsung,pin-pud-pdn = <0x0>;
					samsung,pins = "gpp1-2";
				};

				gpp1-3 {
					samsung,pin-con-pdn = <0x2>;
					samsung,pin-pud-pdn = <0x0>;
					samsung,pins = "gpp1-3";
				};

				gpp1-4 {
					samsung,pin-con-pdn = <0x2>;
					samsung,pin-pud-pdn = <0x0>;
					samsung,pins = "gpp1-4";
				};

				gpp1-5 {
					samsung,pin-con-pdn = <0x2>;
					samsung,pin-pud-pdn = <0x0>;
					samsung,pins = "gpp1-5";
				};
			};
		};
	};

	fragment@58 {
		target = <0xffffffff>;

		__overlay__ {

			isdbt-gpio-active {
				linux,phandle = <0x35>;
				phandle = <0x35>;
				samsung,pin-function = <0x1>;
				samsung,pin-pud = <0x0>;
				samsung,pin-val = <0x0>;
				samsung,pins = "gpg0-2";
			};

			isdbt-gpio-suspend {
				linux,phandle = <0x38>;
				phandle = <0x38>;
				samsung,pin-function = <0x1>;
				samsung,pin-pud = <0x0>;
				samsung,pin-val = <0x0>;
				samsung,pins = "gpg0-2";
			};

			spi9-bus-suspend {
				linux,phandle = <0x34>;
				phandle = <0x34>;
				samsung,pin-drv = <0x0>;
				samsung,pin-function = <0x0>;
				samsung,pin-pud = <0x1>;
				samsung,pin-val = <0x0>;
				samsung,pins = "gpc1-4", "gpc1-5", "gpc1-6", "gpc1-7";
			};
		};
	};

	fragment@59 {
		target = <0xffffffff>;

		__overlay__ {

			isdbt-rst-active {
				linux,phandle = <0x37>;
				phandle = <0x37>;
				samsung,pin-function = <0x1>;
				samsung,pin-pud = <0x0>;
				samsung,pin-val = <0x0>;
				samsung,pins = "gpm15-0";
			};

			isdbt-rst-suspend {
				linux,phandle = <0x3a>;
				phandle = <0x3a>;
				samsung,pin-function = <0x1>;
				samsung,pin-pud = <0x0>;
				samsung,pin-val = <0x0>;
				samsung,pins = "gpm15-0";
			};
		};
	};

	fragment@6 {
		target = <0xffffffff>;

		__overlay__ {
			#address-cells = <0x1>;
			#size-cells = <0x0>;
			clock-frequency = <0x61a80>;
			gpios = <0xffffffff 0x6 0x0 0xffffffff 0x7 0x0>;
			pinctrl-0 = <0xffffffff>;
			pinctrl-1 = <0xffffffff>;
			pinctrl-2 = <0xffffffff>;
			pinctrl-names = "default", "on_i2c", "off_i2c";
			samsung,reset-before-trans;
			status = "okay";

			fimc-is-hi1336@42 {
				compatible = "samsung,exynos5-fimc-is-cis-hi1336";
				id = <0x3>;
				reg = <0x21>;
				sensor_f_number = <0xdc>;
				setfile = "setB";
			};

			fimc-is-macro-gc5035@7E {
				compatible = "samsung,exynos5-fimc-is-cis-gc5035";
				id = <0x4>;
				reg = <0x3f>;
				sensor_bayer_order = <0x0>;
				sensor_f_number = <0xf0>;
				setfile = "setB";
			};
		};
	};

	fragment@60 {
		target = <0xffffffff>;

		__overlay__ {

			isdbt-irq-off {
				linux,phandle = <0x39>;
				phandle = <0x39>;
				samsung,pin-function = <0x0>;
				samsung,pin-pud = <0x1>;
				samsung,pins = "gpa0-4";
			};

			isdbt-irq-on {
				linux,phandle = <0x36>;
				phandle = <0x36>;
				samsung,pin-function = <0xf>;
				samsung,pin-pud = <0x0>;
				samsung,pins = "gpa0-4";
			};
		};
	};

	fragment@61 {
		target = <0xffffffff>;

		__overlay__ {
			dma-mode;
			dmas = <0xffffffff 0x17 0xffffffff 0x16>;
			num-cs = <0x1>;
			pinctrl-0 = <0xffffffff 0xffffffff>;
			pinctrl-1 = <0x34>;
			pinctrl-names = "default", "isdbt_spi_nc";
			status = "ok";
			swap-mode;

			isdbt@0 {
				compatible = "isdbt_spi_comp";
				reg = <0x0>;
				spi-max-frequency = <0x2faf080>;

				controller-data {
					cs-gpio = <0xffffffff 0x7 0x0>;
				};
			};
		};
	};

	fragment@62 {
		target = <0xffffffff>;

		__overlay__ {
			#address-cells = <0x1>;
			#samsung,i2c-max-bus-freq = <0x61a80>;
			#samsung,i2c-sda-delay = <0x64>;
			#size-cells = <0x0>;
			clock-frequency = <0x61a80>;
			gpios = <0xffffffff 0x0 0x0 0xffffffff 0x0 0x0>;
			pinctrl-0 = <0xffffffff>;
			pinctrl-names = "default";
			samsung,reset-before-trans;
			status = "okay";

			sx9360-i2c@28 {
				compatible = "sx9360";
				interrupt-parent = <0xffffffff>;
				interrupts = <0x5 0x0 0x0>;
				pinctrl-0 = <0x3b>;
				pinctrl-names = "default";
				reg = <0x28>;
				status = "okay";
				sx9360,againfreq_reg = <0x58>;
				sx9360,gainrawfilt_reg = <0x1a>;
				sx9360,hallic_cert_detect = <0x1>;
				sx9360,hallic_detect = <0x1>;
				sx9360,hyst_reg = <0x15>;
				sx9360,nirq-gpio = <0xffffffff 0x5 0x0>;
				sx9360,proxthresh_reg = <0x22>;
				sx9360,refagainfreq_reg = <0x36>;
				sx9360,refgainrawfilt_reg = <0x22>;
				sx9360,refresolution_reg = <0xf>;
				sx9360,reggnrlctrl2_reg = <0x32>;
				sx9360,regproxctrl3_reg = <0xc>;
				sx9360,resolution_reg = <0xf>;
			};
		};
	};

	fragment@63 {
		target = <0xffffffff>;

		__overlay__ {

			rt5665@1b {
				realtek,ext-ant-det-gpio = <0xffffffff 0x4 0x0>;
				realtek,gpio-dtv-check = <0xffffffff 0x2 0x0>;
				realtek,sar-hs-open-gender = <0x79e>;
			};
		};
	};

	fragment@64 {
		target = <0xffffffff>;

		__overlay__ {

			earant-det {
				linux,phandle = <0x8>;
				phandle = <0x8>;
				samsung,pin-function = <0xf>;
				samsung,pin-pud = <0x0>;
				samsung,pins = "gpa1-4";
			};

			grip-int {
				linux,phandle = <0x3b>;
				phandle = <0x3b>;
				samsung,pin-function = <0xf>;
				samsung,pin-pud = <0x0>;
				samsung,pins = "gpa2-5";
			};

			grip-sub-int {
				linux,phandle = <0x1f>;
				phandle = <0x1f>;
				samsung,pin-function = <0xf>;
				samsung,pin-pud = <0x0>;
				samsung,pins = "gpa2-7";
			};
		};
	};

	fragment@65 {
		target = <0xffffffff>;

		__overlay__ {

			grip-sub-i2c {
				linux,phandle = <0x1e>;
				phandle = <0x1e>;
				samsung,pin-function = <0x2>;
				samsung,pin-pud = <0x0>;
				samsung,pins = "gpp1-2", "gpp1-3";
			};
		};
	};

	fragment@7 {
		target = <0xffffffff>;

		__overlay__ {
			#address-cells = <0x1>;
			#size-cells = <0x0>;
			clock-frequency = <0x61a80>;
			gpios = <0xffffffff 0x1 0x0 0xffffffff 0x0 0x0>;
			pinctrl-0 = <0xffffffff>;
			pinctrl-1 = <0xffffffff>;
			pinctrl-2 = <0xffffffff>;
			pinctrl-names = "default", "on_i2c", "off_i2c";
			samsung,reset-before-trans;
			status = "okay";

			rear3_eeprom@A8 {
				compatible = "samsung,rear3-eeprom-i2c";
				reg = <0x54>;
			};

			rear4_eeprom@A4 {
				compatible = "samsung,rear4-eeprom-i2c";
				reg = <0x52>;
			};
		};
	};

	fragment@8 {
		target = <0xffffffff>;

		__overlay__ {
			#address-cells = <0x1>;
			#size-cells = <0x0>;
			clock-frequency = <0x61a80>;
			gpios = <0xffffffff 0x3 0x0 0xffffffff 0x2 0x0>;
			pinctrl-0 = <0xffffffff>;
			pinctrl-1 = <0xffffffff>;
			pinctrl-2 = <0xffffffff>;
			pinctrl-names = "default", "on_i2c", "off_i2c";
			samsung,reset-before-trans;
			status = "okay";

			fimc-is-actuator@18 {
				compatible = "samsung,exynos5-fimc-is-actuator-dw9808";
				id = <0x0>;
				place = <0x0>;
				reg = <0xc>;
			};

			front_eeprom@A2 {
				compatible = "samsung,front-eeprom-i2c";
				reg = <0x51>;
			};

			rear_eeprom@B0 {
				compatible = "samsung,rear-eeprom-i2c";
				reg = <0x58>;
				use_common_rom_position = <0x2>;
			};
		};
	};

	fragment@9 {
		target = <0xffffffff>;

		__overlay__ {

			sm5713-fled@49 {
				compatible = "siliconmitus,sm5713-fled";

				sm5713-fled@0 {
					flash-brightness = <0xf>;
					flash-en-gpio = <0xffffffff 0x6 0x0>;
					id = <0x0>;
					preflash-brightness = <0x4>;
					status = "okay";
					timeout = <0xff>;
					torch-brightness = <0x4>;
					torch-brightness-levels = <0x1 0x2 0x3 0x4 0x5>;
					torch-en-gpio = <0xffffffff 0x3 0x0>;
				};
			};
		};
	};

	fragment@battery {
		target-path = [2f 00];

		__overlay__ {

			battery {
				#io-channel-cells = <0x5>;
				battery,adc_check_count = <0x5>;
				battery,age_data = <0x0 0x10fe 0x10b8 0x109a 0x5d 0x12c 0x10ea 0x10a4 0x1086 0x5c 0x190 0x10d6 0x1090 0x1072 0x5b 0x2bc 0x10c2 0x107c 0x105e 0x5a 0x3e8 0x1090 0x104a 0x102c 0x59>;
				battery,battery_check_type = <0x0>;
				battery,battery_full_capacity = <0xc1c>;
				battery,cable_check_type = <0x4>;
				battery,cable_source_type = <0x1>;
				battery,charger_name = "sm5713-charger";
				battery,charging_reset_time = <0x0>;
				battery,charging_total_time = <0x3840>;
				battery,check_adc_max = <0x5a0>;
				battery,check_adc_min = <0x0>;
				battery,check_count = <0x0>;
				battery,chg_charging_limit_current = <0x6a4>;
				battery,chg_float_voltage = <0x10fe>;
				battery,chg_gpio_full_check = <0x0>;
				battery,chg_heating_prevention_method = <0x0>;
				battery,chg_high_temp = <0x1f4>;
				battery,chg_high_temp_recovery = <0x1e0>;
				battery,chg_input_limit_current = <0x3e8>;
				battery,chg_ocp_current = <0x1194>;
				battery,chg_polarity_full_check = <0x1>;
				battery,chg_temp_check_type = <0x2>;
				battery,chg_temp_table_adc = <0x122 0x153 0x187 0x1cd 0x21e 0x277 0x2ad 0x2df 0x32a 0x355 0x3e6 0x486 0x4fc 0x53a 0x58f 0x5fb 0x6c8 0x7be 0x8b0 0x974 0x9fa 0xa4f 0xaa8 0xb13 0xbd6 0xc73 0xcfe 0xd85 0xdea>;
				battery,chg_temp_table_data = <0x384 0x352 0x320 0x2ee 0x2bc 0x28a 0x26c 0x258 0x244 0x226 0x1f4 0x1c2 0x1a4 0x190 0x17c 0x15e 0x12c 0xfa 0xc8 0x96 0x78 0x64 0x50 0x32 0x0 0xffffffce 0xffffff9c 0xffffff6a 0xffffff38>;
				battery,chg_thermal_source = <0x3>;
				battery,chip_vendor = "LSI";
				battery,cisd_alg_index = <0x7>;
				battery,cisd_max_voltage_thr = <0x1130>;
				battery,enable_water_resistance;
				battery,expired_time = <0x2c88>;
				battery,fgsrc_switch_name = "sm5713-fuelgauge";
				battery,fuelgauge_name = "sm5713-fuelgauge";
				battery,full_check_count = <0x1>;
				battery,full_check_type = <0x2>;
				battery,full_check_type_2nd = <0x2>;
				battery,full_condition_soc = <0x5d>;
				battery,full_condition_type = <0xd>;
				battery,full_condition_vcell = <0x109a>;
				battery,health_condition = <0x384 0x0 0x4b0 0x0 0x5dc 0x0>;
				battery,hv_charging_total_time = <0x2a30>;
				battery,ignore_cisd_index = <0x0 0x3c0>;
				battery,ignore_cisd_index_d = <0x0 0x78>;
				battery,inbat_voltage = <0x1>;
				battery,inbat_voltage_table_adc = <0xb01 0xaf3 0xadf 0xac1 0xaa8 0xa8d 0xa78 0xa5e 0xa44 0xa25 0xa05 0x9e8 0x9cd 0x9ae 0x992 0x97a 0x961 0x944 0x927 0x911 0x8f2>;
				battery,inbat_voltage_table_data = <0x111f 0x1100 0x10d2 0x109d 0x106c 0x1038 0x1005 0xfd5 0xfa2 0xf72 0xf3f 0xf0c 0xed9 0xea6 0xe76 0xe46 0xe11 0xde0 0xdaf 0xd80 0xd4a>;
				battery,input_current_by_siop_20 = <0x3e8>;
				battery,max_charging_charge_power = <0x3a98>;
				battery,max_charging_current = <0x960>;
				battery,max_input_current = <0xbb8>;
				battery,max_input_voltage = <0x2328>;
				battery,mix_high_chg_temp = <0x1f4>;
				battery,mix_high_temp = <0x1a4>;
				battery,mix_high_temp_recovery = <0x186>;
				battery,monitor_initial_count = <0x0>;
				battery,normal_charging_total_time = <0x4650>;
				battery,ovp_uvlo_check_type = <0x3>;
				battery,pd_charging_charge_power = <0x3a98>;
				battery,polling_time = <0xa 0x1e 0x1e 0x1e 0xe10>;
				battery,polling_type = <0x1>;
				battery,pre_afc_input_current = <0x1f4>;
				battery,prepare_ta_delay = <0x0>;
				battery,recharge_check_count = <0x1>;
				battery,recharge_condition_soc = <0x62>;
				battery,recharge_condition_type = <0x4>;
				battery,recharge_condition_vcell = <0x10b8>;
				battery,recharging_expired_time = <0x1518>;
				battery,recharging_total_time = <0x1518>;
				battery,rp_current_abnormal_rp3 = <0x708>;
				battery,rp_current_rdu_rp3 = <0x834>;
				battery,rp_current_rp1 = <0x1f4>;
				battery,rp_current_rp2 = <0x5dc>;
				battery,rp_current_rp3 = <0xbb8>;
				battery,siop_call_cc_current = <0x14a>;
				battery,siop_call_cv_current = <0x14a>;
				battery,siop_charging_limit_current = <0x3e8>;
				battery,siop_event_check_type = <0x1>;
				battery,siop_hv_charging_limit_current = <0x3e8>;
				battery,siop_hv_input_limit_current = <0x2bc>;
				battery,siop_hv_wireless_charging_limit_current = <0x2bc>;
				battery,siop_hv_wireless_input_limit_current = <0x258>;
				battery,siop_input_limit_current = <0x4b0>;
				battery,siop_store_hv_wireless_input_limit_current = <0x1c2>;
				battery,siop_wireless_charging_limit_current = <0x2bc>;
				battery,siop_wireless_input_limit_current = <0x258>;
				battery,sleep_mode_limit_current = <0x1f4>;
				battery,standard_curr = <0x960>;
				battery,swelling_drop_float_voltage = <0x1036>;
				battery,swelling_high_rechg_voltage = <0xfa0>;
				battery,swelling_high_temp_block = <0x19a>;
				battery,swelling_high_temp_current = <0x4e2>;
				battery,swelling_high_temp_recov = <0x186>;
				battery,swelling_high_temp_topoff = <0x96>;
				battery,swelling_low_rechg_voltage = <0xfa0>;
				battery,swelling_low_temp_block_1st = <0x96>;
				battery,swelling_low_temp_block_2nd = <0x32>;
				battery,swelling_low_temp_current = <0x352>;
				battery,swelling_low_temp_current_2nd = <0x15e>;
				battery,swelling_low_temp_recov_1st = <0xaa>;
				battery,swelling_low_temp_recov_2nd = <0x46>;
				battery,swelling_low_temp_topoff = <0x96>;
				battery,swelling_wc_high_temp_current = <0x352>;
				battery,swelling_wc_low_temp_current = <0x352>;
				battery,swelling_wc_low_temp_current_2nd = <0x15e>;
				battery,technology = <0x2>;
				battery,temp_adc_type = <0x1>;
				battery,temp_check_count = <0x1>;
				battery,temp_check_type = <0x2>;
				battery,temp_high_recovery_lpm = <0x1e0>;
				battery,temp_high_recovery_normal = <0x1e0>;
				battery,temp_high_threshold_lpm = <0x1f4>;
				battery,temp_high_threshold_normal = <0x1f4>;
				battery,temp_highlimit_recovery_lpm = <0x2a8>;
				battery,temp_highlimit_recovery_normal = <0x2a8>;
				battery,temp_highlimit_threshold_lpm = <0x2bc>;
				battery,temp_highlimit_threshold_normal = <0x2bc>;
				battery,temp_low_recovery_lpm = <0x14>;
				battery,temp_low_recovery_normal = <0x14>;
				battery,temp_low_threshold_lpm = <0x0>;
				battery,temp_low_threshold_normal = <0x0>;
				battery,temp_table_adc = <0x13a 0x16c 0x1a2 0x1ec 0x240 0x28e 0x2dd 0x310 0x391 0x413 0x435 0x453 0x475 0x497 0x4ba 0x4dc 0x4fe 0x520 0x542 0x565 0x5d5 0x648 0x710 0x80d 0x905 0x9c6 0xa4c 0xaa5 0xb02 0xb6b 0xc28 0xcb9 0xd48 0xdbb 0xe1c>;
				battery,temp_table_data = <0x384 0x352 0x320 0x2ee 0x2bc 0x28a 0x26c 0x258 0x226 0x1f4 0x1ea 0x1e0 0x1d6 0x1cc 0x1c2 0x1b8 0x1ae 0x1a4 0x19a 0x190 0x17c 0x15e 0x12c 0xfa 0xc8 0x96 0x78 0x64 0x50 0x32 0x0 0xffffffce 0xffffff9c 0xffffff6a 0xffffff38>;
				battery,thermal_source = <0x3>;
				battery,ttf_hv_charge_current = <0x866>;
				battery,ttf_hv_wireless_charge_current = <0x41a>;
				battery,ttf_wireless_charge_current = <0x384>;
				battery,usb_charging_total_time = <0x8ca0>;
				battery,usb_temp_check_type = <0x0>;
				battery,usb_thermal_source = <0x0>;
				battery,vendor = "Battery";
				battery,wc_full_input_limit_current = <0x64>;
				battery,wpc_charging_limit_current = <0x3e8>;
				battery,wpc_high_recovery_normal = <0x1ae>;
				battery,wpc_high_temp = <0x17c>;
				battery,wpc_high_temp_recovery = <0x168>;
				battery,wpc_high_threshold_normal = <0x1c2>;
				battery,wpc_input_limit_current = <0x258>;
				battery,wpc_lcd_on_high_temp = <0x17c>;
				battery,wpc_lcd_on_high_temp_rec = <0x168>;
				battery,wpc_lcd_on_input_limit_current = <0x1c2>;
				battery,wpc_low_recovery_normal = <0x14>;
				battery,wpc_low_threshold_normal = <0x0>;
				battery,wpc_store_high_temp = <0x168>;
				battery,wpc_store_high_temp_recovery = <0x154>;
				battery,wpc_store_lcd_on_charging_limit_current = <0x190>;
				battery,wpc_store_lcd_on_high_temp = <0x168>;
				battery,wpc_store_lcd_on_high_temp_rec = <0x12c>;
				battery,wpc_temp_check_type = <0x0>;
				battery,wpc_temp_control_source = <0x0>;
				battery,wpc_temp_lcd_on_control_source = <0x0>;
				battery,wpc_thermal_source = <0x0>;
				compatible = "samsung,sec-battery";
				io-channel-names = "adc-temp", "adc-in-bat", "adc-chg-temp";
				io-channel-ranges;
				io-channels = <0xffffffff 0x1 0xffffffff 0x2 0xffffffff 0x3>;
				pinctrl-names = "default";
				status = "okay";
			};

			cable-info {
				default_charging_current = <0x834>;
				default_input_current = <0x708>;
				full_check_current_1st = <0x12c>;
				full_check_current_2nd = <0x96>;

				current_group_1 {
					cable_number = <0x2 0x13 0x15 0x16 0x17 0x1e>;
					charging_current = <0x1f4>;
					input_current = <0x1f4>;
				};

				current_group_10 {
					cable_number = <0xb 0xe 0x10 0x1c 0x23>;
					charging_current = <0x960>;
					input_current = <0x2ee>;
				};

				current_group_11 {
					cable_number = <0x1d 0x24 0x25>;
					charging_current = <0x578>;
					input_current = <0x1f4>;
				};

				current_group_12 {
					cable_number = <0x1 0x4>;
					charging_current = <0x226>;
					input_current = <0x1db>;
				};

				current_group_13 {
					cable_number = <0x22>;
					charging_current = <0xb22>;
					input_current = <0x4b0>;
				};

				current_group_2 {
					cable_number = <0x19 0x1f>;
					charging_current = <0x3e8>;
					input_current = <0x3e8>;
				};

				current_group_3 {
					cable_number = <0x5 0x20>;
					charging_current = <0x5dc>;
					input_current = <0x5dc>;
				};

				current_group_4 {
					cable_number = <0x6 0x7 0x8>;
					charging_current = <0x960>;
					input_current = <0x672>;
				};

				current_group_5 {
					cable_number = <0x9>;
					charging_current = <0x960>;
					input_current = <0x672>;
				};

				current_group_6 {
					cable_number = <0xa 0xc 0xf 0x1b 0x21>;
					charging_current = <0x960>;
					input_current = <0x334>;
				};

				current_group_7 {
					cable_number = <0xd>;
					charging_current = <0x960>;
					input_current = <0x2ee>;
				};

				current_group_8 {
					cable_number = <0x18>;
					charging_current = <0x1c2>;
					input_current = <0x3e8>;
				};

				current_group_9 {
					cable_number = <0x1a>;
					charging_current = <0x708>;
					input_current = <0x7d0>;
				};
			};

			pdic-manager {
				pdic,giveback = <0x0>;
				pdic,max_current = <0x7d0>;
				pdic,max_power = <0x1388>;
				pdic,max_voltage = <0x1770>;
				pdic,min_current = <0x1f4>;
				pdic,no_usb_suspend = <0x1>;
				pdic,op_power = <0x9c4>;
				pdic,usb_com_capable = <0x1>;
				source,max_power = <0x9c4>;
				source,max_voltage = <0x1388>;
				source,min_voltage = <0xfa0>;
			};

			sm5713-fuelgauge {
				fuelgauge,capacity_calculation_type = <0x1f>;
				fuelgauge,capacity_max = <0x3e8>;
				fuelgauge,capacity_max_margin = <0x12c>;
				fuelgauge,capacity_min = <0x0>;
				fuelgauge,cv_data = <0x8c5 0x34b 0x7aa 0x874 0x354 0x76e 0x7f3 0x35c 0x72a 0x791 0x367 0x6e2 0x727 0x370 0x6a5 0x681 0x380 0x648 0x5e8 0x385 0x5ea 0x569 0x390 0x58c 0x4f9 0x39a 0x522 0x460 0x3a4 0x496 0x3f6 0x3ad 0x41c 0x399 0x3ba 0x3a4 0x2fc 0x3c3 0x2d0 0x29c 0x3ca 0x23a 0x246 0x3d4 0x150 0x194 0x3de 0x5d 0x188 0x3e8 0x0>;
				fuelgauge,fuel_alert_soc = <0x1>;
				fuelgauge,low_temp_limit = <0x64>;
				fuelgauge,sw_v_empty_recover_voltage = <0xd98>;
				fuelgauge,sw_v_empty_voltage = <0xc80>;
				fuelgauge,sw_v_empty_voltage_cisd = <0xc1c>;
				fuelgauge,ttf_capacity = <0xd7a>;
				fuelgauge,using_hw_vempty;
				fuelgauge,using_temp_compensation;
				status = "okay";

				battery_params {
					battery,id = <0x0>;
					battery0,age_cntl = <0x325>;
					battery0,arsm = <0x1 0x3 0x1 0x6>;
					battery0,battery_table0 = <0x1400 0x1b5c 0x1c3a 0x1cba 0x1d15 0x1d71 0x1d85 0x1d8b 0x1de2 0x1e07 0x1e3a 0x1e5d 0x1e7b 0x1ea2 0x1ed6 0x1efd 0x1f69 0x1fb2 0x1fdf 0x2018 0x2078 0x20c3 0x21f2 0x2400>;
					battery0,battery_table1 = <0x0 0x99 0x1b3 0x2cc 0x3cc 0x580 0x819 0xacc 0x12cc 0x1819 0x2033 0x2833 0x2d80 0x32e6 0x3833 0x3ae6 0x4033 0x4599 0x4ae6 0x4d99 0x5033 0x5599 0x6400 0x6419>;
					battery0,battery_table2 = <0x4b 0x44 0x40 0x3e 0x3c 0x3b 0x38 0x37 0x35 0x34 0x34 0x33 0x33 0x33 0x33 0x32>;
					battery0,battery_type = <0x1130 0x0 0x1678>;
					battery0,coeff = <0x2700>;
					battery0,curr_cal = <0x887d 0x887d 0x887d 0x8080 0x8080 0x8080>;
					battery0,curr_offset = <0x1 0x0 0x0 0x0 0x0 0x0 0x0>;
					battery0,cycle_cfg = <0x0 0x0 0x0>;
					battery0,data_ver = <0x1>;
					battery0,dtcd_value = <0x1>;
					battery0,ext_temp_cal = <0x0 0x2 0x1 0x2 0x1 0x1 0x2 0x3 0x2 0x3>;
					battery0,full_offset = <0x0 0x32 0x0 0xd1 0x90>;
					battery0,misc = <0x0>;
					battery0,mix_value = <0x103 0x4>;
					battery0,q_max_table = <0x1678 0x15f8 0x1578 0x14f8 0x13cc>;
					battery0,rce_value = <0x4e1 0x3e6 0x1d7>;
					battery0,rs_value = <0xa4 0x147 0x146 0x3800 0x7a>;
					battery0,tcal_ioff = <0x2 0x30>;
					battery0,tem_poff = <0xd48 0x32 0xcb2 0x32>;
					battery0,temp_cal = <0x0 0x6 0x1 0xb 0xffffffff 0x1 0x6 0x1 0x9 0x1>;
					battery0,temp_offset = <0x1 0xb 0x1 0x1 0x8 0xffffffff>;
					battery0,temp_std = <0x19>;
					battery0,temp_volcal = <0x1 0xf 0x1>;
					battery0,topoff_soc = <0x0 0x3 0x190>;
					battery0,v_alarm = <0xc1c 0x0>;
					battery0,v_max_table = <0x21f2 0x21cf 0x21ac 0x2189 0x2140>;
					battery0,v_offset_cancel = <0x0 0x0 0x64 0xa>;
					battery0,vit_period = <0xa0a>;
					battery0,volt_cal = <0x8012 0x8012>;
				};
			};
		};
	};

	fragment@camera {
		target-path = [2f 00];

		__overlay__ {

			fimc-fimc_is_sensor_imx582@1A {
				compatible = "samsung,sensor-module-imx582";
				gpio_ldo_en = <0xffffffff 0x0 0x1>;
				gpio_mclk = <0xffffffff 0x0 0x1>;
				gpio_reset = <0xffffffff 0x1 0x1>;
				id = <0x0>;
				linux,phandle = <0x3e>;
				mclk_ch = <0x0>;
				phandle = <0x3e>;
				pinctrl-0 = <0xffffffff>;
				pinctrl-1 = <0xffffffff>;
				pinctrl-2;
				pinctrl-3;
				pinctrl-names = "pin0", "pin1", "pin2", "release";
				position = <0x0>;
				sensor_i2c_addr = <0x1a>;
				sensor_i2c_ch = <0x1>;
				shared_mclk;
				status = "okay";
				use_pdaf;

				af {
					i2c_addr = <0x18>;
					i2c_ch = <0x5>;
					product_name = <0x13>;
				};

				flash {
					product_name = <0xb>;
				};

				internal_vc {
					vc_list = <0x2 0x2 0x1 0x3 0x4 0x1>;
				};
			};

			fimc-is-flash-gpio@0 {
				compatible = "samsung,sensor-flash-sm5713";
				flash-gpio = <0xffffffff 0x6 0x1>;
				id = <0x0 0x4>;
				linux,phandle = <0x3f>;
				phandle = <0x3f>;
				status = "okay";
				torch-gpio = <0xffffffff 0x3 0x1>;
			};

			fimc-is_macro_sensor_gc5035@7E {
				compatible = "samsung,sensor-module-gc5035";
				gpio_cam_a2p8_1p2_en = <0xffffffff 0x7 0x1>;
				gpio_mclk = <0xffffffff 0x2 0x1>;
				gpio_reset = <0xffffffff 0x1 0x1>;
				id = <0x4>;
				linux,phandle = <0x43>;
				mclk_ch = <0x2>;
				phandle = <0x43>;
				pinctrl-0;
				pinctrl-1 = <0xffffffff>;
				pinctrl-2 = <0xffffffff>;
				pinctrl-3;
				pinctrl-names = "pin0", "pin1", "pin2", "release";
				position = <0x6>;
				shared_mclk;
				status = "okay";
				use_2nd_module;

				flash {
					product_name = <0xb>;
				};
			};

			fimc-is_sensor_gc5035@6E {
				compatible = "samsung,sensor-module-gc5035";
				gpio_mclk = <0xffffffff 0x0 0x1>;
				gpio_reset = <0xffffffff 0x7 0x1>;
				id = <0x2>;
				linux,phandle = <0x40>;
				mclk_ch = <0x0>;
				phandle = <0x40>;
				pinctrl-0;
				pinctrl-1 = <0xffffffff>;
				pinctrl-2 = <0xffffffff>;
				pinctrl-3;
				pinctrl-names = "pin0", "pin1", "pin2", "release";
				position = <0x2>;
				shared_mclk;
				status = "okay";
			};

			fimc-is_sensor_hi1336@42 {
				compatible = "samsung,sensor-module-hi1336";
				gpio_cam_a2p8_en = <0xffffffff 0x6 0x1>;
				gpio_mclk = <0xffffffff 0x2 0x1>;
				gpio_reset = <0xffffffff 0x4 0x1>;
				id = <0x3>;
				linux,phandle = <0x41>;
				mclk_ch = <0x2>;
				phandle = <0x41>;
				pinctrl-0 = <0xffffffff>;
				pinctrl-1 = <0xffffffff>;
				pinctrl-2;
				pinctrl-3;
				pinctrl-names = "pin0", "pin1", "pin2", "release";
				position = <0x4>;
				shared_mclk;
				status = "okay";
			};

			fimc-is_sensor_imx616@1A {
				compatible = "samsung,sensor-module-imx616";
				gpio_mclk = <0xffffffff 0x1 0x1>;
				gpio_reset = <0xffffffff 0x7 0x1>;
				id = <0x1>;
				linux,phandle = <0x42>;
				mclk_ch = <0x1>;
				phandle = <0x42>;
				pinctrl-0;
				pinctrl-1 = <0xffffffff>;
				pinctrl-2 = <0xffffffff>;
				pinctrl-3;
				pinctrl-names = "pin0", "pin1", "pin2", "release";
				position = <0x1>;
				sensor_i2c_ch = <0x0>;
				status = "okay";

				internal_vc {
					vc_list = <0x2 0x5 0x0 0x3 0x3 0x0>;
				};
			};
		};
	};

	fragment@inputbooster {
		target-path = [2f 00];

		__overlay__ {

			input_booster {
				#address-cells = <0x1>;
				#size-cells = <0x0>;
				compatible = "input_booster";
				status = "okay";

				booster_key@1 {
					input_booster,cpu_freqs = <0x1174c0>;
					input_booster,dma_latency = <0x0>;
					input_booster,head_times = <0x1f4>;
					input_booster,hmp_boost = <0x1>;
					input_booster,int_freqs = <0x0>;
					input_booster,kfc_freqs = <0x0>;
					input_booster,label = "KEY";
					input_booster,levels = <0x1>;
					input_booster,mif_freqs = <0x0>;
					input_booster,phase_times = <0x0>;
					input_booster,tail_times = <0x1f4>;
					input_booster,type = <0x0>;
				};

				booster_key@10 {
					input_booster,cpu_freqs = <0x1702a0>;
					input_booster,dma_latency = <0x0>;
					input_booster,head_times = <0x2bc>;
					input_booster,hmp_boost = <0x1>;
					input_booster,int_freqs = <0x0>;
					input_booster,kfc_freqs = <0x101148>;
					input_booster,label = "KEY_TWO";
					input_booster,levels = <0x1>;
					input_booster,mif_freqs = <0x0>;
					input_booster,phase_times = <0x0>;
					input_booster,tail_times = <0x2bc>;
					input_booster,type = <0x9>;
				};

				booster_key@2 {
					input_booster,cpu_freqs = <0x1174c0>;
					input_booster,dma_latency = <0x0>;
					input_booster,head_times = <0x0>;
					input_booster,hmp_boost = <0x1>;
					input_booster,int_freqs = <0x0>;
					input_booster,kfc_freqs = <0x0>;
					input_booster,label = "TOUCHKEY";
					input_booster,levels = <0x1>;
					input_booster,mif_freqs = <0x0>;
					input_booster,phase_times = <0x0>;
					input_booster,tail_times = <0xc8>;
					input_booster,type = <0x1>;
				};

				booster_key@3 {
					input_booster,cpu_freqs = <0x1174c0 0x1174c0 0xe4840>;
					input_booster,dma_latency = <0x0 0x0 0x0>;
					input_booster,head_times = <0x82 0x82 0x0>;
					input_booster,hmp_boost = <0x1 0x1 0x1>;
					input_booster,int_freqs = <0x0 0x0 0x0>;
					input_booster,kfc_freqs = <0xc4c70 0xc4c70 0xc4c70>;
					input_booster,label = "TOUCH";
					input_booster,levels = <0x1 0x2 0x3>;
					input_booster,mif_freqs = <0xf78f0 0xf78f0 0xf78f0>;
					input_booster,phase_times = <0x0 0x0 0x0>;
					input_booster,tail_times = <0x0 0x0 0x1f4>;
					input_booster,type = <0x2>;
				};

				booster_key@4 {
					input_booster,cpu_freqs = <0x1174c0 0xe4840>;
					input_booster,dma_latency = <0x0 0x0>;
					input_booster,head_times = <0x3e8 0x0>;
					input_booster,hmp_boost = <0x1 0x1>;
					input_booster,int_freqs = <0x0 0x0>;
					input_booster,kfc_freqs = <0xc4c70 0xc4c70>;
					input_booster,label = "MULTITOUCH";
					input_booster,levels = <0x1 0x2>;
					input_booster,mif_freqs = <0xf78f0 0xf78f0>;
					input_booster,phase_times = <0x0 0x0>;
					input_booster,tail_times = <0x0 0x1f4>;
					input_booster,type = <0x3>;
				};

				booster_key@5 {
					input_booster,cpu_freqs = <0x1174c0 0x1174c0>;
					input_booster,dma_latency = <0x0 0x0>;
					input_booster,head_times = <0x82 0x82>;
					input_booster,hmp_boost = <0x1 0x1>;
					input_booster,int_freqs = <0x0 0x0>;
					input_booster,kfc_freqs = <0xc4c70 0xc4c70>;
					input_booster,label = "KEYBOARD";
					input_booster,levels = <0x1 0x2>;
					input_booster,mif_freqs = <0x0 0x0>;
					input_booster,phase_times = <0x0 0x0>;
					input_booster,tail_times = <0x0 0x0>;
					input_booster,type = <0x4>;
				};

				booster_key@6 {
					input_booster,cpu_freqs = <0x1174c0 0xe4840>;
					input_booster,dma_latency = <0x0 0x0>;
					input_booster,head_times = <0x82 0x0>;
					input_booster,hmp_boost = <0x1 0x1>;
					input_booster,int_freqs = <0x0 0x0>;
					input_booster,kfc_freqs = <0xc4c70 0xc4c70>;
					input_booster,label = "MOUSE";
					input_booster,levels = <0x1 0x2>;
					input_booster,mif_freqs = <0x0 0x0>;
					input_booster,phase_times = <0x0 0x0>;
					input_booster,tail_times = <0x0 0x1f4>;
					input_booster,type = <0x5>;
				};

				booster_key@7 {
					input_booster,cpu_freqs = <0x1174c0 0x0>;
					input_booster,dma_latency = <0x0 0x0>;
					input_booster,head_times = <0x82 0x0>;
					input_booster,hmp_boost = <0x1 0x0>;
					input_booster,int_freqs = <0x0 0x0>;
					input_booster,kfc_freqs = <0xc4c70 0x0>;
					input_booster,label = "MOUSE WHEEL";
					input_booster,levels = <0x1 0x2>;
					input_booster,mif_freqs = <0x0 0x0>;
					input_booster,phase_times = <0x0 0x0>;
					input_booster,tail_times = <0x0 0x0>;
					input_booster,type = <0x6>;
				};

				booster_key@8 {
					input_booster,cpu_freqs = <0x1174c0 0xe4840>;
					input_booster,dma_latency = <0x0 0x0>;
					input_booster,head_times = <0x82 0x0>;
					input_booster,hmp_boost = <0x1 0x1>;
					input_booster,int_freqs = <0x0 0x0>;
					input_booster,kfc_freqs = <0xc4c70 0xc4c70>;
					input_booster,label = "PEN HOVER";
					input_booster,levels = <0x1 0x2>;
					input_booster,mif_freqs = <0x0 0x0>;
					input_booster,phase_times = <0x0 0x0>;
					input_booster,tail_times = <0x0 0x1f4>;
					input_booster,type = <0x7>;
				};

				booster_key@9 {
					input_booster,bimc_freqs = <0x0 0x0>;
					input_booster,cpu_freqs = <0x1fbd00 0xe4840>;
					input_booster,dma_latency = <0x0 0x0>;
					input_booster,head_times = <0x82 0x0>;
					input_booster,hmp_boost = <0x1 0x1>;
					input_booster,kfc_freqs = <0x1a94b0 0xc4c70>;
					input_booster,label = "PEN";
					input_booster,levels = <0x1 0x2>;
					input_booster,tail_times = <0x0 0x258>;
					input_booster,type = <0x8>;
				};
			};
		};
	};

	fragment@isdbt_data {
		target-path = [2f 00];

		__overlay__ {

			isdbt_data {
				compatible = "isdbt_pdata";
				isdbt,gpio-dtv-check = <0xffffffff 0x2 0x0>;
				isdbt,gpio-fm-dtv-ctrl = <0xffffffff 0x6 0x0>;
				isdbt,gpio-lna-en = <0xffffffff 0x2 0x0>;
				isdbt,gpio-tunner-en = <0xffffffff 0x2 0x0>;
				isdbt,gpio-tunner-irq = <0xffffffff 0x4 0x0>;
				isdbt,gpio-tunner-rst = <0xffffffff 0x0 0x0>;
				isdbt,isdb-bbm-xtal-freq = <0x5dc0>;
				isdbt,isdb-gpio-spi_clk = <0xffffffff 0x4 0x0>;
				isdbt,isdb-gpio-spi_cs = <0xffffffff 0x7 0x0>;
				isdbt,isdb-gpio-spi_di = <0xffffffff 0x6 0x0>;
				isdbt,isdb-gpio-spi_do = <0xffffffff 0x5 0x0>;
				isdbt,spi-node = <0xffffffff>;
				isdbt,tuner_id = "fc8350";
				pinctrl-0 = <0x35 0x36 0x37>;
				pinctrl-1 = <0x38 0x39 0x3a>;
				pinctrl-names = "isdbt_gpio_active", "isdbt_gpio_suspend";
			};
		};
	};

	fragment@lcd {
		target-path = [2f 00];

		__overlay__ {

			decon_board_ea8076 {
				gpio_con = <0xffffffff 0x1 0x0>;
				gpio_det = <0xffffffff 0x1 0x1>;
				gpio_err = <0xffffffff 0x1 0x1>;
				gpio_lcd_en_1p8 = <0xffffffff 0x2 0x0>;
				gpio_lcd_en_3p0 = <0xffffffff 0x4 0x0>;
				gpio_lcd_rst = <0xffffffff 0x3 0x0>;
				gpio_pcd = <0xffffffff 0x7 0x1>;
				linux,phandle = <0x2>;
				phandle = <0x2>;

				dsim_reset_panel {
					type = "gpio,high", "gpio_lcd_rst", "delay,usleep", "1000", "gpio,low", "gpio_lcd_rst", "delay,usleep", "1000", "gpio,high", "gpio_lcd_rst", "delay,usleep", "10000";
				};

				dsim_set_panel_power_disable {
					type = "gpio,low", "gpio_lcd_rst", "delay,usleep", "10000", "gpio,low", "gpio_lcd_en_1p8", "delay,usleep", "5000", "gpio,low", "gpio_lcd_en_3p0", "delay,usleep", "5000";
				};

				dsim_set_panel_power_enable {
					type = "gpio,high", "gpio_lcd_en_1p8", "delay,usleep", "1000", "gpio,high", "gpio_lcd_en_3p0", "delay,usleep", "10000";
				};
			};

			decon_board_s6e3fa9 {
				gpio_con = <0xffffffff 0x1 0x0>;
				gpio_det = <0xffffffff 0x1 0x1>;
				gpio_err = <0xffffffff 0x1 0x1>;
				gpio_lcd_en_1p8 = <0xffffffff 0x2 0x0>;
				gpio_lcd_en_3p0 = <0xffffffff 0x4 0x0>;
				gpio_lcd_rst = <0xffffffff 0x3 0x0>;
				gpio_pcd = <0xffffffff 0x7 0x1>;
				linux,phandle = <0x1>;
				phandle = <0x1>;

				dsim_reset_panel {
					type = "gpio,high", "gpio_lcd_rst", "delay,usleep", "10000", "gpio,low", "gpio_lcd_rst", "delay,usleep", "1000", "gpio,high", "gpio_lcd_rst", "delay,usleep", "10000";
				};

				dsim_set_panel_power_disable {
					type = "gpio,low", "gpio_lcd_rst", "delay,usleep", "5000", "gpio,low", "gpio_lcd_en_1p8", "delay,usleep", "5000", "gpio,low", "gpio_lcd_en_3p0", "delay,usleep", "5000";
				};

				dsim_set_panel_power_enable {
					type = "gpio,high", "gpio_lcd_en_1p8", "delay,usleep", "1000", "gpio,high", "gpio_lcd_en_3p0", "delay,usleep", "10000";
				};
			};

			ea8076 {
				cmd_underrun_lp_ref = <0x75e>;
				data_lane = <0x4>;
				decon_board = <0x2>;
				dsc_cnt = <0x0>;
				dsc_en = <0x0>;
				dsc_slice_num = <0x0>;
				id_match = <0xc0 0x80>;
				linux,phandle = <0x3d>;
				mic_en = <0x0>;
				mic_ratio = <0x0>;
				mic_ver = <0x0>;
				mode = <0x2>;
				mres_en = <0x0>;
				noncontinuous_clklane = <0x1>;
				phandle = <0x3d>;
				resolution = <0x438 0x960>;
				size = <0x43 0x96>;
				timing,dsi-escape-clk = <0x10>;
				timing,dsi-hs-clk = <0x4b0>;
				timing,h-porch = <0x2 0x2 0x2>;
				timing,pmsk = <0x3 0x115 0x1 0x0>;
				timing,refresh = <0x3c>;
				timing,v-porch = <0x10 0xb0 0x1>;
				type_of_ddi = <0x1>;
				update_min = <0x438 0x2>;
			};

			s6e3fa9 {
				cmd_underrun_lp_ref = <0x75e>;
				data_lane = <0x4>;
				decon_board = <0x1>;
				dsc_cnt = <0x0>;
				dsc_en = <0x0>;
				dsc_slice_num = <0x0>;
				linux,phandle = <0x3>;
				mic_en = <0x0>;
				mic_ratio = <0x0>;
				mic_ver = <0x0>;
				mode = <0x2>;
				mres_en = <0x0>;
				noncontinuous_clklane = <0x1>;
				phandle = <0x3>;
				resolution = <0x438 0x960>;
				size = <0x43 0x96>;
				timing,dsi-escape-clk = <0x10>;
				timing,dsi-hs-clk = <0x4b0>;
				timing,h-porch = <0x2 0x2 0x2>;
				timing,pmsk = <0x3 0x115 0x1 0x0>;
				timing,refresh = <0x3c>;
				timing,v-porch = <0x10 0xb0 0x1>;
				type_of_ddi = <0x0>;
				update_min = <0x168 0x3c>;
			};
		};
	};

	fragment@model {
		target-path = [2f 00];

		__overlay__ {
			#address-cells = <0x2>;
			#size-cells = <0x1>;
			model = "Samsung A51 EUR OPEN REV00 based on Exynos9611";

			abc_hub {
				compatible = "samsung,abc_hub";
				status = "okay";

				bootc {
					bootc,time_spec_eng = <0x15f90>;
					bootc,time_spec_fac = <0xea60>;
					bootc,time_spec_user = <0x11170>;
				};
			};

			argos {
				#address-cells = <0x1>;
				compatible = "samsung,argos";

				boot_device@1 {
					net_boost,label = "IPC";
					net_boost,node = "rmnet0 rmnet1 rmnet2 rmnet3 rmnet4 rmnet5 rmnet6 rmnet7 umts_dm0";

					net_boost,table {

						level_0 {
							lit_min = <0xde2b0>;
							mif = <0xce4c8>;
							threshold = <0x32>;
						};

						level_1 {
							lit_min = <0x143bb0>;
							mif = <0xf78f0>;
							threshold = <0x64>;
						};

						level_2 {
							lit_min = <0x176830>;
							mif = <0x14a140>;
							threshold = <0xc8>;
						};

						level_3 {
							big_min = <0x196400>;
							lit_min = <0x163780>;
							mif = <0x177bb8>;
							threshold = <0x12c>;
						};
					};
				};

				boot_device@2 {
					net_boost,label = "CLAT";
					net_boost,node = "clat clat4 v4-rmnet0 v4-rmnet1 v4-rmnet2 v4-rmnet3 v4-rmnet4 v4-rmnet5 v4-rmnet6 v4-rmnet7";

					net_boost,table {

						level_0 {
							big_min = <0xfde80>;
							mif = <0xf78f0>;
							threshold = <0x64>;
						};

						level_1 {
							big_min = <0x130b00>;
							mif = <0x14a140>;
							threshold = <0x96>;
						};

						level_2 {
							big_min = <0x163780>;
							mif = <0x1fefc8>;
							threshold = <0xc8>;
						};
					};
				};

				boot_device@3 {
					net_boost,label = "USB";
					net_boost,node = "rndis0";

					net_boost,table {

						level_0 {
							irq_affinity = "enable";
							threshold = <0x0>;
						};
					};
				};
			};

			certify_hall {
				certify_hall,gpio_certify_cover = <0xffffffff 0x2 0x0>;
				compatible = "certify_hall";
				pinctrl-0 = <0x15>;
				pinctrl-names = "default";
				status = "okay";
			};

			dc_vibrator {
				compatible = "samsung,dc_vibrator";
				dc_vib,gpio_en = <0xffffffff 0x5 0x0>;
				dc_vib,motor_type = "COINDC";
				pinctrl-0 = <0x16>;
				pinctrl-names = "default";
				status = "okay";
			};

			dwmmc2@13550000 {
				#address-cells = <0x1>;
				#size-cells = <0x0>;
				bypass-for-allpass;
				card-detect = <0xffffffff 0x4 0xf>;
				card-detect-delay = <0xc8>;
				card-detect-gpio;
				card-detect-invert;
				card-init-hwacg-ctrl;
				ciu_clkin = <0x19 0x32 0x32 0x19 0x32 0x64 0xc8 0x32 0x32>;
				clk-drive-number = <0x4>;
				clock-frequency = <0x2faf0800>;
				data-timeout = <0xc8>;
				desc-size = <0x4>;
				fifo-depth = <0x40>;
				hto-timeout = <0x50>;
				num-ref-clks = <0x9>;
				num-slots = <0x1>;
				pinctrl-0 = <0xffffffff 0xffffffff 0xffffffff 0xffffffff 0x13>;
				pinctrl-1 = <0xffffffff>;
				pinctrl-2 = <0xffffffff>;
				pinctrl-3 = <0xffffffff>;
				pinctrl-4 = <0xffffffff>;
				pinctrl-names = "default", "fast-slew-rate-1x", "fast-slew-rate-2x", "fast-slew-rate-3x", "fast-slew-rate-4x";
				qos-dvfs-int-level = <0x82208>;
				qos-dvfs-mif-level = <0xa50a0>;
				samsung,dw-mshc-ciu-div = <0x3>;
				samsung,dw-mshc-ddr-timing = <0x3 0x0 0x2 0x1>;
				samsung,dw-mshc-sdr-timing = <0x3 0x0 0x2 0x0>;
				samsung,dw-mshc-sdr104-timing = <0x3 0x0 0x3 0x0>;
				samsung,dw-mshc-sdr50-timing = <0x3 0x0 0x4 0x2>;
				sd-uhs-sdr104;
				sd-uhs-sdr50;
				sec-sd-slot-type = <0x2>;
				skip-init-mmc-scan;
				ssc-rate = <0x3>;
				status = "okay";
				supports-4bit;
				supports-cmd23;
				supports-erase;
				supports-highspeed;

				slot@0 {
					bus-width = <0x4>;
					disable-wp;
					reg = <0x0>;
				};
			};

			etspi-spi@0 {
				#gpio-cells = <0x2>;
				clock-names = "gate_spi_clk", "ipclk_spi";
				clocks = <0xffffffff 0x236 0xffffffff 0x240>;
				compatible = "etspi,et7xx";
				etspi-chipid = "ET715";
				etspi-modelinfo = "A515";
				etspi-position = "12.67,0.00,9.10,9.10,14.80,14.80,12.00,12.00,5.00";
				etspi-regulator = "VDD_BTP_3P3";
				etspi-sleepPin = <0xffffffff 0x0 0x0>;
				gpio-controller;
				pinctrl-0 = <0x17>;
				pinctrl-1 = <0x18 0x19 0x1a 0x1b>;
				pinctrl-2 = <0x1c 0x1d>;
				pinctrl-names = "default", "pins_poweron", "pins_poweroff";
				reg = <0x0>;
				spi-max-frequency = <0x2faf080>;

				controller-data {
					cs-gpio = <0xffffffff 0x7 0x0>;
					samsung,spi-chip-select-mode = <0x0>;
					samsung,spi-feedback-delay = <0x0>;
				};
			};

			exynos_rgt {
				compatible = "samsung,exynos-rgt";
			};

			fixed-rate-clocks {

				oscclk {
					clock-frequency = <0x18cba80>;
					compatible = "samsung,exynos9610-oscclk";
				};
			};

			fixedregulator@1 {
				compatible = "regulator-fixed";
				linux,phandle = <0x6e>;
				phandle = <0x6e>;
				regulator-always-on;
				regulator-boot-on;
				regulator-max-microvolt = <0x401640>;
				regulator-min-microvolt = <0x401640>;
				regulator-name = "V_SYS";
			};

			gnss_pdata {
				compatible = "samsung,gnss_shdmem_if";
				fault_info = <0x1 0x200000 0x180000>;
				interrupt-names = "ACTIVE", "WATCHDOG", "WAKEUP", "REQ_INIT";
				interrupts = <0x0 0x1b 0x0 0x0 0x51 0x0 0x0 0x50 0x0 0x0 0x4f 0x0>;
				mbox_info = <0xd>;
				mbx,int_ap2gnss_ack_wake_clr = <0x4>;
				mbx,int_ap2gnss_ack_wake_set = <0x3>;
				mbx,int_ap2gnss_bcmd = <0x0>;
				mbx,int_ap2gnss_ipc_msg = <0x2>;
				mbx,int_ap2gnss_req_fault_info = <0x1>;
				mbx,irq_gnss2ap_bcmd = <0x0>;
				mbx,irq_gnss2ap_ipc_msg = <0x2>;
				mbx,irq_gnss2ap_req_wake_clr = <0x4>;
				mbx,irq_gnss2ap_rsp_fault_info = <0x1>;
				mbx,reg_bcmd_ctrl = <0x0 0x1 0x2 0x3>;
				memory-region = <0xffffffff>;
				reg_rx_head = <0x1 0x3>;
				reg_rx_ipc_msg = <0x1 0x5>;
				reg_rx_tail = <0x1 0x2>;
				reg_tx_head = <0x1 0x1>;
				reg_tx_ipc_msg = <0x1 0x4>;
				reg_tx_tail = <0x1 0x0>;
				shmem,device_node_name = "gnss_ipc";
				shmem,ipc_offset = <0x380000>;
				shmem,ipc_reg_cnt = <0x20>;
				shmem,ipc_size = <0x80000>;
				shmem,name = "KEPLER";
				status = "okay";
			};

			gpio_keys {
				#address-cells = <0x1>;
				#size-cells = <0x0>;
				compatible = "gpio-keys";
				pinctrl-0 = <0xe 0xf 0x10>;
				pinctrl-names = "default";
				status = "okay";

				button@2 {
					gpios = <0xffffffff 0x6 0xf>;
					label = "gpio-keys: KEY_VOLUMEDOWN";
					linux,code = <0x72>;
				};

				button@3 {
					gpios = <0xffffffff 0x5 0xf>;
					label = "gpio-keys: KEY_VOLUMEUP";
					linux,code = <0x73>;
				};

				button@4 {
					gpio-key,wakeup = <0x1>;
					gpios = <0xffffffff 0x7 0xf>;
					label = "gpio-keys: KEY_POWER";
					linux,code = <0x74>;
				};
			};

			hall {
				compatible = "hall";
				hall,gpio_flip_cover = <0xffffffff 0x3 0x0>;
				pinctrl-0 = <0x14>;
				pinctrl-names = "default";
				status = "okay";
			};

			i2c@13870000 {
				#address-cells = <0x1>;
				#size-cells = <0x0>;
				linux,phandle = <0x6d>;
				phandle = <0x6d>;
				samsung,i2c-max-bus-freq = <0x61a80>;
				samsung,i2c-sda-delay = <0x64>;
				status = "okay";

				mms_ts@48 {
					compatible = "melfas,mms_ts";
					enable_settings_aot;
					melfas,area-size = <0x85 0x10a 0x155>;
					melfas,display_resolution = <0x438 0x960>;
					melfas,event_info = <0xa 0x10 0x1>;
					melfas,fod_info = <0x10 0xc 0x18>;
					melfas,fw_name = "tsp_melfas/mss100_a51.fw";
					melfas,fw_name_old = "tsp_melfas/mss100_a51_old.fw";
					melfas,irq-gpio = <0xffffffff 0x0 0x0>;
					melfas,max_x_y = <0xfff 0xfff>;
					melfas,node_info = <0x10 0x22 0x0>;
					melfas,regulator_boot_on;
					melfas,support_dual_fw;
					melfas,support_lpm = "true";
					melfas,support_protos;
					melfas,vdd_en = "tsp_ldo_en";
					pinctrl-0 = <0x11>;
					pinctrl-1 = <0x12>;
					pinctrl-names = "on_state", "off_state";
					reg = <0x48>;
					support_ear_detect_mode;
					support_fod;
					support_open_short_test;
				};
			};

			i2c@20 {
				#address-cells = <0x1>;
				#size-cells = <0x0>;
				compatible = "i2c-gpio";
				gpios = <0xffffffff 0x2 0x0 0xffffffff 0x3 0x0>;
				i2c-gpio,delay-us = <0x5>;
				pinctrl-0 = <0x1e>;
				pinctrl-names = "default";

				sx9360_sub-i2c@28 {
					compatible = "sx9360_sub";
					interrupt-parent = <0xffffffff>;
					interrupts = <0x7 0x0 0x0>;
					pinctrl-0 = <0x1f>;
					pinctrl-names = "default";
					reg = <0x28>;
					status = "okay";
					sx9360,againfreq_reg = <0x58>;
					sx9360,gainrawfilt_reg = <0x1a>;
					sx9360,hyst_reg = <0x15>;
					sx9360,proxthresh_reg = <0x23>;
					sx9360,refagainfreq_reg = <0x36>;
					sx9360,refgainrawfilt_reg = <0x22>;
					sx9360,refresolution_reg = <0xf>;
					sx9360,resolution_reg = <0xf>;
					sx9360_sub,hallic_cert_detect = <0x1>;
					sx9360_sub,hallic_detect = <0x1>;
					sx9360_sub,nirq-gpio = <0xffffffff 0x7 0x0>;
				};
			};

			mcu_ipc@11920000 {
				compatible = "samsung,exynos-shd-ipc-mailbox";
				interrupts = <0x0 0x28 0x0>;
				linux,phandle = <0x6c>;
				mcu,id = <0x0>;
				mcu,irq_affinity_mask = <0x3>;
				mcu,name = "mcu_ipc_cp";
				phandle = <0x6c>;
				reg = <0x0 0x11920000 0x180>;
			};

			mcu_ipc@11A00000 {
				compatible = "samsung,exynos-shd-ipc-mailbox";
				interrupts = <0x0 0x2b 0x0>;
				linux,phandle = <0xd>;
				mcu,id = <0x1>;
				mcu,name = "mcu_ipc_gnss";
				phandle = <0xd>;
				reg = <0x0 0x11a00000 0x180>;
			};

			mif_pdata {
				gpios = <0xffffffff 0x2 0x0 0xffffffff 0x3 0x0 0xffffffff 0x4 0x0 0xffffffff 0x5 0x0>;
				pinctrl-names = "default";
			};

			nad_balancer {
				compatible = "samsung,sec_nad_balancer";
				nad_balancer,timeout = <0x190>;
				status = "okay";

				qos {

					cl0 {
						qos,delay_time = <0xa>;
						qos,label = "LIT";
						qos,table = <0x1a94b0 0x18fe70 0x176830 0x163780 0x143bb0 0x12a570 0x110f30 0x101148 0xde2b0 0xc4c70 0xab630 0x91ff0 0x62638>;
						qos,table_size = <0xd>;
					};

					cl1 {
						qos,delay_time = <0xa>;
						qos,label = "BIG";
						qos,table = <0x234f10 0x21b8d0 0x215340 0x1fbd00 0x1e26c0 0x1cf610 0x1afa40 0x196400 0x1702a0 0x163780 0x14a140 0x130b00 0x1174c0 0xfde80 0xe4840>;
						qos,table_size = <0xf>;
					};

					mif {
						qos,delay_time = <0xa>;
						qos,label = "MIF";
						qos,table = <0x1fefc8 0x1e8c50 0x1b5fd0 0x177bb8 0xcbbc40 0xf78f0 0xce4c8 0xa50a0 0x854d0 0x664b8>;
						qos,table_size = <0xa>;
					};
				};

				sleep {
					sleep,resume_threshold = <0x3e8>;
					sleep,suspend_threshold = <0x3e8>;
				};
			};

			sec-mst {
				compatible = "sec-mst";
				sec-mst,mst-data-gpio = <0xffffffff 0x0 0x0>;
				sec-mst,mst-en-gpio = <0xffffffff 0x0 0x0>;
				sec-mst,mst-support-gpio = <0xffffffff 0x1 0x0>;
			};

			sec_abc {
				compatible = "samsung,sec_abc";
				status = "okay";

				aicl {
					aicl,label = "battery aicl";
					aicl,threshold_count = <0x5>;
					aicl,threshold_time = <0x12c>;
				};

				gpu {
					gpu,label = "GPU fault";
					gpu,threshold_count = <0x14>;
					gpu,threshold_time = <0x4b0>;
				};
			};

			sec_thermistor@0 {
				adc_array = <0x113 0x144 0x17c 0x1c2 0x210 0x26b 0x2d9 0x358 0x3eb 0x489 0x541 0x609 0x6e6 0x7bc 0x8ae 0x999 0xa7d 0xb55 0xc1e 0xccf 0xd62 0xddf 0xe4b>;
				compatible = "samsung,sec-thermistor";
				id = <0x0>;
				io-channel-names = "adc-ap-temp";
				io-channel-ranges;
				io-channels = <0xffffffff 0x0>;
				status = "okay";
				temp_array = <0x384 0x352 0x320 0x2ee 0x2bc 0x28a 0x258 0x226 0x1f4 0x1c2 0x190 0x15e 0x12c 0xfa 0xc8 0x96 0x64 0x32 0x0 0xffffffce 0xffffff9c 0xffffff6a 0xffffff38>;
				thermistor_name = "sec-ap-thermistor";
			};

			sec_thermistor@6 {
				adc_array = <0x113 0x144 0x17c 0x1c2 0x210 0x26b 0x2d9 0x358 0x3eb 0x489 0x541 0x609 0x6e6 0x7bc 0x8ae 0x999 0xa7d 0xb55 0xc1e 0xccf 0xd62 0xddf 0xe4b>;
				compatible = "samsung,sec-thermistor";
				id = <0x1>;
				io-channel-names = "adc-wf-temp";
				io-channel-ranges;
				io-channels = <0xffffffff 0x6>;
				status = "okay";
				temp_array = <0x384 0x352 0x320 0x2ee 0x2bc 0x28a 0x258 0x226 0x1f4 0x1c2 0x190 0x15e 0x12c 0xfa 0xc8 0x96 0x64 0x32 0x0 0xffffffce 0xffffff9c 0xffffff6a 0xffffff38>;
				thermistor_name = "sec-wf-thermistor";
			};

			sec_vib {
				compatible = "sec_vib";

				sec_vib_pdata {
					sec_vib,ldo_en = <0xffffffff 0x5 0x0>;
					sec_vib,ldo_type = <0x1>;
					sec_vib,max_timeout = <0x2710>;
					status = "okay";
				};
			};

			secgpio_dvs {
				compatible = "samsung,exynos9610-secgpio-dvs";
				status = "okay";
			};

			speedy@11a10000 {
				#address-cells = <0x1>;
				#size-cells = <0x0>;
				status = "okay";

				s2mpu09mfd@00 {
					acpm-ipc-channel = <0x2>;
					check_jigon = <0x0>;
					compatible = "samsung,s2mpu09mfd";
					i2c-speedy-address;
					init_time,hour = <0xc>;
					init_time,mday = <0x1>;
					init_time,min = <0x0>;
					init_time,mon = <0x0>;
					init_time,sec = <0x0>;
					init_time,wday = <0x2>;
					init_time,year = <0x77>;
					interrupt-parent = <0xffffffff>;
					interrupts = <0x2 0x0 0x0>;
					pinctrl-0 = <0xb 0xc>;
					pinctrl-names = "default";
					reg = <0x0>;
					s2mpu09,irq-gpio = <0xffffffff 0x0 0x0>;
					s2mpu09,wakeup = "enabled";
					smpl_en = "enabled";
					smpl_timer_val = <0x0>;
					wtsr_en = "enabled";
					wtsr_timer_val = <0x3>;

					regulators {

						BUCK1 {
							linux,phandle = <0x4b>;
							phandle = <0x4b>;
							regulator-always-on;
							regulator-initial-mode = <0x2>;
							regulator-max-microvolt = <0x10c8e0>;
							regulator-min-microvolt = <0x7a120>;
							regulator-name = "vdd_mif";
							regulator-ramp-delay = <0x2ee0>;
						};

						BUCK2 {
							linux,phandle = <0x4c>;
							phandle = <0x4c>;
							regulator-always-on;
							regulator-initial-mode = <0x1>;
							regulator-max-microvolt = <0x13d620>;
							regulator-min-microvolt = <0x7a120>;
							regulator-name = "vdd_cpucl1";
							regulator-ramp-delay = <0x2ee0>;
						};

						BUCK3 {
							linux,phandle = <0x4d>;
							phandle = <0x4d>;
							regulator-always-on;
							regulator-initial-mode = <0x1>;
							regulator-max-microvolt = <0x13d620>;
							regulator-min-microvolt = <0x7a120>;
							regulator-name = "vdd_cpucl0";
							regulator-ramp-delay = <0x2ee0>;
						};

						BUCK4 {
							linux,phandle = <0x4e>;
							phandle = <0x4e>;
							regulator-always-on;
							regulator-initial-mode = <0x2>;
							regulator-max-microvolt = <0x10c8e0>;
							regulator-min-microvolt = <0x7a120>;
							regulator-name = "vdd_int";
							regulator-ramp-delay = <0x2ee0>;
						};

						BUCK5 {
							linux,phandle = <0x4f>;
							phandle = <0x4f>;
							regulator-always-on;
							regulator-initial-mode = <0x2>;
							regulator-max-microvolt = <0x124f80>;
							regulator-min-microvolt = <0x7a120>;
							regulator-name = "vdd_g3d";
							regulator-ramp-delay = <0x2ee0>;
						};

						BUCK6 {
							linux,phandle = <0x50>;
							phandle = <0x50>;
							regulator-always-on;
							regulator-initial-mode = <0x2>;
							regulator-max-microvolt = <0x13d620>;
							regulator-min-microvolt = <0x7a120>;
							regulator-name = "vdd_cam_vipx";
							regulator-ramp-delay = <0x2ee0>;
						};

						BUCK7 {
							linux,phandle = <0x51>;
							phandle = <0x51>;
							regulator-always-on;
							regulator-initial-mode = <0x3>;
							regulator-max-microvolt = <0x13d620>;
							regulator-min-microvolt = <0x7a120>;
							regulator-name = "vdd2_mem";
							regulator-ramp-delay = <0x2ee0>;
						};

						BUCK8 {
							linux,phandle = <0x52>;
							phandle = <0x52>;
							regulator-always-on;
							regulator-initial-mode = <0x3>;
							regulator-max-microvolt = <0x16e360>;
							regulator-min-microvolt = <0x124f80>;
							regulator-name = "vdd_lldo";
							regulator-ramp-delay = <0x2ee0>;
						};

						BUCK9 {
							linux,phandle = <0x53>;
							phandle = <0x53>;
							regulator-always-on;
							regulator-initial-mode = <0x3>;
							regulator-max-microvolt = <0x200b20>;
							regulator-min-microvolt = <0x1b7740>;
							regulator-name = "vdd_mldo";
							regulator-ramp-delay = <0x2ee0>;
						};

						LDO1 {
							linux,phandle = <0x54>;
							phandle = <0x54>;
							regulator-always-on;
							regulator-initial-mode = <0x3>;
							regulator-max-microvolt = <0x13d620>;
							regulator-min-microvolt = <0xaae60>;
							regulator-name = "vdd_ldo1";
							regulator-ramp-delay = <0x2ee0>;
						};

						LDO10 {
							linux,phandle = <0x5d>;
							phandle = <0x5d>;
							regulator-always-on;
							regulator-initial-mode = <0x1>;
							regulator-max-microvolt = <0x13d620>;
							regulator-min-microvolt = <0x7a120>;
							regulator-name = "vdd_ldo10";
							regulator-ramp-delay = <0x2ee0>;
						};

						LDO11 {
							linux,phandle = <0x5e>;
							phandle = <0x5e>;
							regulator-always-on;
							regulator-initial-mode = <0x3>;
							regulator-max-microvolt = <0x13d620>;
							regulator-min-microvolt = <0x7a120>;
							regulator-name = "vdd_ldo11";
							regulator-ramp-delay = <0x2ee0>;
						};

						LDO12 {
							linux,phandle = <0x5f>;
							phandle = <0x5f>;
							regulator-initial-mode = <0x3>;
							regulator-max-microvolt = <0x13d620>;
							regulator-min-microvolt = <0xc3500>;
							regulator-name = "vdd_ldo12";
							regulator-ramp-delay = <0x2ee0>;
						};

						LDO13 {
							linux,phandle = <0x60>;
							phandle = <0x60>;
							regulator-initial-mode = <0x3>;
							regulator-max-microvolt = <0x1dc130>;
							regulator-min-microvolt = <0xc3500>;
							regulator-name = "vdd_ldo13";
							regulator-ramp-delay = <0x2ee0>;
						};

						LDO14 {
							linux,phandle = <0x61>;
							phandle = <0x61>;
							regulator-initial-mode = <0x3>;
							regulator-max-microvolt = <0x337f98>;
							regulator-min-microvolt = <0x1b7740>;
							regulator-name = "vdd_ldo14";
							regulator-ramp-delay = <0x2ee0>;
						};

						LDO2 {
							linux,phandle = <0x55>;
							phandle = <0x55>;
							regulator-max-microvolt = <0x337f98>;
							regulator-min-microvolt = <0x1b7740>;
							regulator-name = "vqmmc";
							regulator-ramp-delay = <0x2ee0>;
						};

						LDO3 {
							linux,phandle = <0x56>;
							phandle = <0x56>;
							regulator-always-on;
							regulator-initial-mode = <0x3>;
							regulator-max-microvolt = <0x1dc130>;
							regulator-min-microvolt = <0xc3500>;
							regulator-name = "vdd_ldo3";
							regulator-ramp-delay = <0x2ee0>;
						};

						LDO33 {
							linux,phandle = <0x62>;
							phandle = <0x62>;
							regulator-initial-mode = <0x3>;
							regulator-max-microvolt = <0x1b7740>;
							regulator-min-microvolt = <0x1b7740>;
							regulator-name = "vdd_ldo33";
						};

						LDO34 {
							linux,phandle = <0x63>;
							phandle = <0x63>;
							regulator-max-microvolt = <0x337f98>;
							regulator-min-microvolt = <0x1b7740>;
							regulator-name = "vdd_ldo34";
							regulator-ramp-delay = <0x2ee0>;
						};

						LDO35 {
							linux,phandle = <0x64>;
							phandle = <0x64>;
							regulator-max-microvolt = <0x337f98>;
							regulator-min-microvolt = <0x1b7740>;
							regulator-name = "vmmc";
							regulator-ramp-delay = <0x2ee0>;
						};

						LDO36 {
							linux,phandle = <0x65>;
							phandle = <0x65>;
							regulator-always-on;
							regulator-initial-mode = <0x1>;
							regulator-max-microvolt = <0x13d620>;
							regulator-min-microvolt = <0x7a120>;
							regulator-name = "vdd_ldo36";
							regulator-ramp-delay = <0x2ee0>;
						};

						LDO37 {
							linux,phandle = <0x66>;
							phandle = <0x66>;
							regulator-max-microvolt = <0x2ab980>;
							regulator-min-microvolt = <0x2ab980>;
							regulator-name = "vdd_ldo37";
							regulator-ramp-delay = <0x2ee0>;
						};

						LDO38 {
							linux,phandle = <0x67>;
							phandle = <0x67>;
							regulator-max-microvolt = <0x325aa0>;
							regulator-min-microvolt = <0x325aa0>;
							regulator-name = "VDD_BTP_3P3";
							regulator-ramp-delay = <0x2ee0>;
						};

						LDO39 {
							linux,phandle = <0x68>;
							phandle = <0x68>;
							regulator-initial-mode = <0x3>;
							regulator-max-microvolt = <0x1b7740>;
							regulator-min-microvolt = <0x1b7740>;
							regulator-name = "vdd_ldo39";
						};

						LDO4 {
							linux,phandle = <0x57>;
							phandle = <0x57>;
							regulator-always-on;
							regulator-initial-mode = <0x1>;
							regulator-max-microvolt = <0x10c8e0>;
							regulator-min-microvolt = <0x7a120>;
							regulator-name = "vdd_ldo4";
							regulator-ramp-delay = <0x2ee0>;
						};

						LDO40 {
							linux,phandle = <0xa>;
							phandle = <0xa>;
							regulator-boot-on;
							regulator-initial-mode = <0x3>;
							regulator-max-microvolt = <0x325aa0>;
							regulator-min-microvolt = <0x325aa0>;
							regulator-name = "regulator_3v3";
						};

						LDO41 {
							linux,phandle = <0x69>;
							phandle = <0x69>;
							regulator-max-microvolt = <0x337f98>;
							regulator-min-microvolt = <0x1b7740>;
							regulator-name = "vdd_ldo41";
							regulator-ramp-delay = <0x2ee0>;
						};

						LDO42 {
							linux,phandle = <0x9>;
							phandle = <0x9>;
							regulator-boot-on;
							regulator-initial-mode = <0x3>;
							regulator-max-microvolt = <0x1b7740>;
							regulator-min-microvolt = <0x1b7740>;
							regulator-name = "regulator_1v8";
							regulator-ramp-delay = <0x2ee0>;
						};

						LDO43 {
							linux,phandle = <0x6a>;
							phandle = <0x6a>;
							regulator-always-on;
							regulator-initial-mode = <0x1>;
							regulator-max-microvolt = <0x13d620>;
							regulator-min-microvolt = <0x7a120>;
							regulator-name = "vdd_ldo43";
							regulator-ramp-delay = <0x2ee0>;
						};

						LDO44 {
							linux,phandle = <0x6b>;
							phandle = <0x6b>;
							regulator-max-microvolt = <0x124f80>;
							regulator-min-microvolt = <0x124f80>;
							regulator-name = "vdd_ldo44";
							regulator-ramp-delay = <0x2ee0>;
						};

						LDO5 {
							linux,phandle = <0x58>;
							phandle = <0x58>;
							regulator-always-on;
							regulator-initial-mode = <0x1>;
							regulator-max-microvolt = <0x13d620>;
							regulator-min-microvolt = <0xc3500>;
							regulator-name = "vdd_ldo5";
							regulator-ramp-delay = <0x2ee0>;
						};

						LDO6 {
							linux,phandle = <0x59>;
							phandle = <0x59>;
							regulator-always-on;
							regulator-initial-mode = <0x1>;
							regulator-max-microvolt = <0x13d620>;
							regulator-min-microvolt = <0xc3500>;
							regulator-name = "vdd_ldo6";
							regulator-ramp-delay = <0x2ee0>;
						};

						LDO7 {
							linux,phandle = <0x5a>;
							phandle = <0x5a>;
							regulator-always-on;
							regulator-initial-mode = <0x1>;
							regulator-max-microvolt = <0x1dc130>;
							regulator-min-microvolt = <0xc3500>;
							regulator-name = "vdd_ldo7";
							regulator-ramp-delay = <0x2ee0>;
						};

						LDO8 {
							linux,phandle = <0x5b>;
							phandle = <0x5b>;
							regulator-always-on;
							regulator-initial-mode = <0x1>;
							regulator-max-microvolt = <0x13d620>;
							regulator-min-microvolt = <0x7a120>;
							regulator-name = "vdd_ldo8";
							regulator-ramp-delay = <0x2ee0>;
						};

						LDO9 {
							linux,phandle = <0x5c>;
							phandle = <0x5c>;
							regulator-always-on;
							regulator-initial-mode = <0x1>;
							regulator-max-microvolt = <0x13d620>;
							regulator-min-microvolt = <0x7a120>;
							regulator-name = "vdd_ldo9";
							regulator-ramp-delay = <0x2ee0>;
						};
					};
				};
			};

			tsp_ldo_en {
				compatible = "regulator-fixed";
				enable-active-high;
				gpio = <0xffffffff 0x1 0x0>;
				regulator-boot-on;
				regulator-max-microvolt = <0x2dc6c0>;
				regulator-min-microvolt = <0x2dc6c0>;
				regulator-name = "tsp_ldo_en";
			};

			ufs-srpmb {
				compatible = "samsung,ufs-srpmb";
				interrupts = <0x0 0x1cc 0x0>;
			};

			usb3_hs_tune {
				hs_tune_cnt = <0xa>;
				linux,phandle = <0x21>;
				phandle = <0x21>;

				hs_tune1 {
					tune_name = "tx_pre_emp";
					tune_value = <0x3 0x3>;
				};

				hs_tune10 {
					tune_name = "utim_clk";
					tune_value = <0x1 0x1>;
				};

				hs_tune2 {
					tune_name = "tx_pre_emp_plus";
					tune_value = <0x0 0x0>;
				};

				hs_tune3 {
					tune_name = "tx_vref";
					tune_value = <0x7 0x7>;
				};

				hs_tune4 {
					tune_name = "rx_sqrx";
					tune_value = <0x7 0x7>;
				};

				hs_tune5 {
					tune_name = "tx_rise";
					tune_value = <0x3 0x3>;
				};

				hs_tune6 {
					tune_name = "compdis";
					tune_value = <0x7 0x7>;
				};

				hs_tune7 {
					tune_name = "tx_hsxv";
					tune_value = <0x3 0x3>;
				};

				hs_tune8 {
					tune_name = "tx_fsls";
					tune_value = <0x3 0x3>;
				};

				hs_tune9 {
					tune_name = "tx_res";
					tune_value = <0x3 0x3>;
				};
			};

			usb3_ss_tune {
				linux,phandle = <0x22>;
				phandle = <0x22>;
				ss_tune_cnt = <0xf>;

				ss_tune1 {
					tune_name = "tx0_term_offset";
					tune_value = <0x0 0x0>;
				};

				ss_tune10 {
					tune_name = "tx_eye_height_cntl_en";
					tune_value = <0x1 0x1>;
				};

				ss_tune11 {
					tune_name = "pipe_tx_deemph_update_delay";
					tune_value = <0x2 0x2>;
				};

				ss_tune12 {
					tune_name = "pcs_tx_swing_full_sstx";
					tune_value = <0x7f 0x7f>;
				};

				ss_tune13 {
					tune_name = "rx_eq_fix_val";
					tune_value = <0x2 0x2>;
				};

				ss_tune14 {
					tune_name = "rx_decode_mode";
					tune_value = <0x1 0x1>;
				};

				ss_tune15 {
					tune_name = "decrese_ss_tx_imp";
					tune_value = <0x1 0x1>;
				};

				ss_tune2 {
					tune_name = "pcs_tx_swing_full";
					tune_value = <0x7f 0x7f>;
				};

				ss_tune3 {
					tune_name = "pcs_tx_deemph_6db";
					tune_value = <0x1c 0x1c>;
				};

				ss_tune4 {
					tune_name = "pcs_tx_deemph_3p5db";
					tune_value = <0x1c 0x1c>;
				};

				ss_tune5 {
					tune_name = "tx_vboost_lvl_sstx";
					tune_value = <0x7 0x7>;
				};

				ss_tune6 {
					tune_name = "tx_vboost_lvl";
					tune_value = <0x4 0x4>;
				};

				ss_tune7 {
					tune_name = "los_level";
					tune_value = <0x9 0x9>;
				};

				ss_tune8 {
					tune_name = "los_bias";
					tune_value = <0x5 0x5>;
				};

				ss_tune9 {
					tune_name = "pcs_rx_los_mask_val";
					tune_value = <0x104 0x104>;
				};
			};

			usb_hs_tune {
				hs_tune_cnt = <0xc>;
				linux,phandle = <0x20>;
				phandle = <0x20>;

				hs_tune1 {
					tune_name = "tx_vref";
					tune_value = <0xf 0xa>;
				};

				hs_tune10 {
					tune_name = "otg";
					tune_value = <0x2 0x2>;
				};

				hs_tune11 {
					tune_name = "enable_user_imp";
					tune_value = <0x0 0x0>;
				};

				hs_tune12 {
					tune_name = "is_phyclock";
					tune_value = <0x1 0x1>;
				};

				hs_tune2 {
					tune_name = "tx_pre_emp";
					tune_value = <0x3 0x3>;
				};

				hs_tune3 {
					tune_name = "tx_pre_emp_plus";
					tune_value = <0x0 0x0>;
				};

				hs_tune4 {
					tune_name = "tx_res";
					tune_value = <0x3 0x3>;
				};

				hs_tune5 {
					tune_name = "tx_rise";
					tune_value = <0x3 0x3>;
				};

				hs_tune6 {
					tune_name = "tx_hsxv";
					tune_value = <0x3 0x3>;
				};

				hs_tune7 {
					tune_name = "tx_fsls";
					tune_value = <0x3 0x3>;
				};

				hs_tune8 {
					tune_name = "rx_sqrx";
					tune_value = <0x7 0x7>;
				};

				hs_tune9 {
					tune_name = "compdis";
					tune_value = <0x7 0x7>;
				};
			};

			usb_notifier {
				compatible = "samsung,usb-notifier";
				disable_host_wakelock;
				udc = <0xffffffff>;
			};
		};
	};

	fragment@modemif {
		target-path = [2f 00];

		__overlay__ {
			#address-cells = <0x2>;
			#size-cells = <0x1>;

			mif_pdata {
				compatible = "sec_modem,modem_pdata";
				interrupts = <0x0 0x4b 0x0>;
				mbx_ap2cp_kerneltime = <0x9>;
				mbx_ap2cp_mif_value = <0x4>;
				mbx_ap2cp_msg = <0x0>;
				mbx_ap2cp_united_status = <0x2>;
				mbx_cp2ap_dvfsreq = <0x4>;
				mbx_cp2ap_dvfsreq_cpu = <0x5>;
				mbx_cp2ap_dvfsreq_int = <0x7>;
				mbx_cp2ap_dvfsreq_mif = <0x6>;
				mbx_cp2ap_msg = <0x1>;
				mbx_cp2ap_pcie_l1ss_disable = <0x11>;
				mbx_cp2ap_united_status = <0x3>;
				mif,int_ap2cp_active = <0x3>;
				mif,int_ap2cp_msg = <0x0>;
				mif,int_ap2cp_status = <0x2>;
				mif,int_ap2cp_uart_noti = <0xf>;
				mif,int_ap2cp_wakeup = <0x1>;
				mif,ipc_version = <0x32>;
				mif,irq_cp2ap_active = <0x3>;
				mif,irq_cp2ap_msg = <0x0>;
				mif,irq_cp2ap_pcie_l1ss_disable = <0x9>;
				mif,irq_cp2ap_perf_req_cpu = <0x5>;
				mif,irq_cp2ap_perf_req_int = <0x7>;
				mif,irq_cp2ap_perf_req_mif = <0x6>;
				mif,irq_cp2ap_status = <0x2>;
				mif,irq_cp2ap_wakelock = <0x8>;
				mif,link_attrs = <0x7c9>;
				mif,link_name = "shmem";
				mif,link_types = <0x200>;
				mif,modem_net = <0x0>;
				mif,modem_type = <0xa>;
				mif,name = "s337ap";
				mif,num_iodevs = <0x16>;
				mif,use_handover = <0x0>;
				mif,use_usb_phy = <0x0>;
				reg = <0x0 0x10000 0x0>;
				sbi_ap2cp_kerneltime_sec_mask = <0xfff>;
				sbi_ap2cp_kerneltime_sec_pos = <0x14>;
				sbi_ap2cp_kerneltime_usec_mask = <0xfffff>;
				sbi_ap2cp_kerneltime_usec_pos = <0x0>;
				sbi_ap_status_mask = <0xf>;
				sbi_ap_status_pos = <0x1>;
				sbi_cp2ap_wakelock_mask = <0x1>;
				sbi_cp2ap_wakelock_pos = <0x6>;
				sbi_cp_evs_mode_mask = <0x1>;
				sbi_cp_evs_mode_pos = <0x7>;
				sbi_cp_rat_mode_mask = <0x3f>;
				sbi_cp_rat_mode_pos = <0x1a>;
				sbi_cp_status_mask = <0xf>;
				sbi_cp_status_pos = <0x1>;
				sbi_crash_type_mask = <0xf>;
				sbi_crash_type_pos = <0x19>;
				sbi_device_type_mask = <0x1f>;
				sbi_device_type_pos = <0x14>;
				sbi_ds_det_mask = <0x3>;
				sbi_ds_det_pos = <0xe>;
				sbi_ext_backtrace_mask = <0x1>;
				sbi_ext_backtrace_pos = <0x11>;
				sbi_lockval_cp2ap_dvfsreq_endian_mask = <0x1>;
				sbi_lockval_cp2ap_dvfsreq_endian_pos = <0x1f>;
				sbi_lockval_cp2ap_dvfsreq_index_mask = <0x7fff>;
				sbi_lockval_cp2ap_dvfsreq_index_pos = <0x0>;
				sbi_lte_active_mask = <0x1>;
				sbi_lte_active_pos = <0x5>;
				sbi_pda_active_mask = <0x1>;
				sbi_pda_active_pos = <0x5>;
				sbi_sys_rev_mask = <0xff>;
				sbi_sys_rev_pos = <0x6>;
				sbi_uart_noti_mask = <0x1>;
				sbi_uart_noti_pos = <0x10>;
				status = "okay";

				iodevs {

					io_device_0 {
						iod,attrs = <0x82>;
						iod,dl_buffer_size = <0x800>;
						iod,dl_num_buffers = <0x10>;
						iod,format = <0x1>;
						iod,id = <0x23>;
						iod,io_type = <0x0>;
						iod,links = <0x200>;
						iod,max_tx_size = <0x800>;
						iod,name = "umts_cass";
						iod,ul_buffer_size = <0x800>;
						iod,ul_num_buffers = <0x10>;
					};

					io_device_1 {
						iod,app = "RIL";
						iod,attrs = <0x82>;
						iod,dl_buffer_size = <0x1000>;
						iod,dl_num_buffers = <0x20>;
						iod,format = <0x0>;
						iod,id = <0xeb>;
						iod,io_type = <0x0>;
						iod,links = <0x200>;
						iod,name = "umts_ipc0";
						iod,ul_buffer_size = <0x1000>;
						iod,ul_num_buffers = <0x10>;
					};

					io_device_10 {
						iod,app = "NET";
						iod,attrs = <0x180>;
						iod,dl_buffer_size = <0x800>;
						iod,dl_num_buffers = <0x0>;
						iod,format = <0x1>;
						iod,id = <0xd>;
						iod,io_type = <0x1>;
						iod,links = <0x200>;
						iod,name = "rmnet3";
						iod,ul_buffer_size = <0x800>;
						iod,ul_num_buffers = <0x0>;
					};

					io_device_11 {
						iod,attrs = <0x180>;
						iod,dl_buffer_size = <0x800>;
						iod,dl_num_buffers = <0x0>;
						iod,format = <0x1>;
						iod,id = <0xe>;
						iod,io_type = <0x1>;
						iod,links = <0x200>;
						iod,name = "rmnet4";
						iod,ul_buffer_size = <0x800>;
						iod,ul_num_buffers = <0x0>;
					};

					io_device_12 {
						iod,attrs = <0x180>;
						iod,dl_buffer_size = <0x800>;
						iod,dl_num_buffers = <0x0>;
						iod,format = <0x1>;
						iod,id = <0xf>;
						iod,io_type = <0x1>;
						iod,links = <0x200>;
						iod,name = "rmnet5";
						iod,ul_buffer_size = <0x800>;
						iod,ul_num_buffers = <0x0>;
					};

					io_device_13 {
						iod,attrs = <0x180>;
						iod,dl_buffer_size = <0x800>;
						iod,dl_num_buffers = <0x0>;
						iod,format = <0x1>;
						iod,id = <0x10>;
						iod,io_type = <0x1>;
						iod,links = <0x200>;
						iod,name = "rmnet6";
						iod,ul_buffer_size = <0x800>;
						iod,ul_num_buffers = <0x0>;
					};

					io_device_14 {
						iod,attrs = <0x180>;
						iod,dl_buffer_size = <0x800>;
						iod,dl_num_buffers = <0x0>;
						iod,format = <0x1>;
						iod,id = <0x11>;
						iod,io_type = <0x1>;
						iod,links = <0x200>;
						iod,name = "rmnet7";
						iod,ul_buffer_size = <0x800>;
						iod,ul_num_buffers = <0x0>;
					};

					io_device_15 {
						iod,app = "RIL";
						iod,attrs = <0x180>;
						iod,dl_buffer_size = <0x800>;
						iod,dl_num_buffers = <0x100>;
						iod,format = <0x3>;
						iod,id = <0x0>;
						iod,io_type = <0x2>;
						iod,links = <0x200>;
						iod,name = "multipdp_hiprio";
						iod,ul_buffer_size = <0x800>;
						iod,ul_num_buffers = <0x100>;
					};

					io_device_16 {
						iod,app = "RIL";
						iod,attrs = <0x180>;
						iod,dl_buffer_size = <0x800>;
						iod,dl_num_buffers = <0x400>;
						iod,format = <0x3>;
						iod,id = <0x0>;
						iod,io_type = <0x2>;
						iod,links = <0x200>;
						iod,name = "multipdp";
						iod,ul_buffer_size = <0x800>;
						iod,ul_num_buffers = <0x200>;
					};

					io_device_17 {
						iod,app = "CBD";
						iod,attrs = <0x2>;
						iod,format = <0x4>;
						iod,id = <0xd7>;
						iod,io_type = <0x0>;
						iod,links = <0x200>;
						iod,name = "umts_boot0";
					};

					io_device_18 {
						iod,app = "CBD";
						iod,attrs = <0x202>;
						iod,format = <0x5>;
						iod,id = <0xe1>;
						iod,io_type = <0x0>;
						iod,links = <0x200>;
						iod,name = "umts_ramdump0";
					};

					io_device_19 {
						iod,app = "VCD";
						iod,attrs = <0x882>;
						iod,dl_buffer_size = <0x800>;
						iod,dl_num_buffers = <0x80>;
						iod,format = <0x1>;
						iod,id = <0x20>;
						iod,io_type = <0x0>;
						iod,links = <0x200>;
						iod,max_tx_size = <0x800>;
						iod,name = "umts_atc0";
						iod,option_region = "usa_vzw";
						iod,ul_buffer_size = <0x800>;
						iod,ul_num_buffers = <0x10>;
					};

					io_device_2 {
						iod,app = "RIL";
						iod,attrs = <0x82>;
						iod,dl_buffer_size = <0x1000>;
						iod,dl_num_buffers = <0x20>;
						iod,format = <0x0>;
						iod,id = <0xec>;
						iod,io_type = <0x0>;
						iod,links = <0x200>;
						iod,name = "umts_ipc1";
						iod,ul_buffer_size = <0x1000>;
						iod,ul_num_buffers = <0x10>;
					};

					io_device_20 {
						iod,attrs = <0x882>;
						iod,dl_buffer_size = <0x800>;
						iod,dl_num_buffers = <0x80>;
						iod,format = <0x1>;
						iod,id = <0x22>;
						iod,io_type = <0x0>;
						iod,links = <0x200>;
						iod,name = "smd4";
						iod,option_region = "usa_";
						iod,ul_buffer_size = <0x800>;
						iod,ul_num_buffers = <0x10>;
					};

					io_device_21 {
						iod,attrs = <0x882>;
						iod,dl_buffer_size = <0x800>;
						iod,dl_num_buffers = <0x80>;
						iod,format = <0x1>;
						iod,id = <0x1a>;
						iod,io_type = <0x0>;
						iod,links = <0x200>;
						iod,name = "umts_ciq0";
						iod,option_region = "usa_";
						iod,ul_buffer_size = <0x800>;
						iod,ul_num_buffers = <0x10>;
					};

					io_device_3 {
						iod,app = "RFS";
						iod,attrs = <0x82>;
						iod,dl_buffer_size = <0x800>;
						iod,dl_num_buffers = <0x200>;
						iod,format = <0x2>;
						iod,id = <0xf5>;
						iod,io_type = <0x0>;
						iod,links = <0x200>;
						iod,name = "umts_rfs0";
						iod,ul_buffer_size = <0x800>;
						iod,ul_num_buffers = <0x10>;
					};

					io_device_4 {
						iod,app = "CSVT";
						iod,attrs = <0x82>;
						iod,dl_buffer_size = <0x800>;
						iod,dl_num_buffers = <0x40>;
						iod,format = <0x1>;
						iod,id = <0x1>;
						iod,io_type = <0x0>;
						iod,links = <0x200>;
						iod,name = "umts_csd";
						iod,ul_buffer_size = <0x800>;
						iod,ul_num_buffers = <0x20>;
					};

					io_device_5 {
						iod,app = "Data Router";
						iod,attrs = <0x82>;
						iod,dl_buffer_size = <0x800>;
						iod,dl_num_buffers = <0x10>;
						iod,format = <0x1>;
						iod,id = <0x19>;
						iod,io_type = <0x0>;
						iod,links = <0x200>;
						iod,max_tx_size = <0x60e>;
						iod,name = "umts_router";
						iod,ul_buffer_size = <0x800>;
						iod,ul_num_buffers = <0x10>;
					};

					io_device_6 {
						iod,app = "DIAG";
						iod,attrs = <0x82>;
						iod,dl_buffer_size = <0x800>;
						iod,dl_num_buffers = <0x80>;
						iod,format = <0x1>;
						iod,id = <0x1c>;
						iod,io_type = <0x0>;
						iod,links = <0x200>;
						iod,name = "umts_dm0";
						iod,ul_buffer_size = <0x800>;
						iod,ul_num_buffers = <0x10>;
					};

					io_device_7 {
						iod,app = "NET";
						iod,attrs = <0x180>;
						iod,dl_buffer_size = <0x800>;
						iod,dl_num_buffers = <0x0>;
						iod,format = <0x1>;
						iod,id = <0xa>;
						iod,io_type = <0x1>;
						iod,links = <0x200>;
						iod,name = "rmnet0";
						iod,ul_buffer_size = <0x800>;
						iod,ul_num_buffers = <0x0>;
					};

					io_device_8 {
						iod,app = "NET";
						iod,attrs = <0x180>;
						iod,dl_buffer_size = <0x800>;
						iod,dl_num_buffers = <0x0>;
						iod,format = <0x1>;
						iod,id = <0xb>;
						iod,io_type = <0x1>;
						iod,links = <0x200>;
						iod,name = "rmnet1";
						iod,ul_buffer_size = <0x800>;
						iod,ul_num_buffers = <0x0>;
					};

					io_device_9 {
						iod,app = "NET";
						iod,attrs = <0x180>;
						iod,dl_buffer_size = <0x800>;
						iod,dl_num_buffers = <0x0>;
						iod,format = <0x1>;
						iod,id = <0xc>;
						iod,io_type = <0x1>;
						iod,links = <0x200>;
						iod,name = "rmnet2";
						iod,ul_buffer_size = <0x800>;
						iod,ul_num_buffers = <0x0>;
					};
				};
			};

			shmem@F0000000 {
				compatible = "samsung,exynos-shm_ipc";
				linux,phandle = <0x3c>;
				phandle = <0x3c>;
				shmem,cp_size = <0x7900000>;
				shmem,ipc_offset = <0x8000000>;
				shmem,ipc_size = <0x800000>;
				shmem,vss_size = <0x700000>;
			};
		};
	};

	fragment@sound {
		target-path = [2f 00];

		__overlay__ {

			audio_codec_dummy {
				compatible = "snd-soc-dummy";
				linux,phandle = <0x4>;
				phandle = <0x4>;
				status = "okay";
			};

			audio_cpu_dummy {
				compatible = "samsung,dummy-cpu";
				linux,phandle = <0x45>;
				phandle = <0x45>;
				status = "okay";
			};

			sound {
				clock-names = "xclkout";
				clocks = <0xffffffff 0x321>;
				compatible = "samsung,exynos9610-audio";
				pinctrl-0 = <0xffffffff>;
				pinctrl-names = "default";
				samsung,aux = <0xffffffff 0xffffffff>;
				samsung,codec = <0xffffffff 0xffffffff 0xffffffff 0xffffffff 0xffffffff 0xffffffff 0xffffffff>;
				samsung,prefix = "ABOX", "ABOX", "ABOX", "ABOX", "ABOX", "ABOX", "ABOX";
				samsung,routing = "HEADSETMIC", "MICBIAS1", "MAINMIC", "MICBIAS2", "SUBMIC", "MICBIAS3", "IN1P", "HEADSETMIC", "IN1N", "HEADSETMIC", "IN3P", "MAINMIC", "IN3N", "MAINMIC", "IN4P", "SUBMIC", "IN4N", "SUBMIC", "RECEIVER", "MONOOUT", "RECEIVER", "MONOOUT", "HEADPHONE", "HPOL", "HEADPHONE", "HPOR", "VOUTPUT", "ABOX UAIF0 Playback", "SPEAKER", "ABOX UAIF2 Playback", "VOUTPUTCALL", "ABOX SIFS0 Playback", "BLUETOOTH SPK", "ABOX SIFS2 Playback", "ABOX SPDY Capture", "FM IN", "ABOX SIFS2 Capture", "BLUETOOTH MIC", "ABOX SIFS0 Capture", "VINPUTCALL";
				status = "okay";

				dsif@0 {
					format = "pdm";

					codec {
						sound-dai = <0x4>;
					};

					cpu {
						sound-dai = <0xffffffff>;
					};
				};

				rdma@0 {

					codec {
						sound-dai = <0x4>;
					};

					cpu {
						sound-dai = <0xffffffff 0x0>;
					};

					platform {
						sound-dai = <0xffffffff>;
					};
				};

				rdma@1 {

					codec {
						sound-dai = <0x4>;
					};

					cpu {
						sound-dai = <0xffffffff 0x1>;
					};

					platform {
						sound-dai = <0xffffffff>;
					};
				};

				rdma@2 {

					codec {
						sound-dai = <0x4>;
					};

					cpu {
						sound-dai = <0xffffffff 0x2>;
					};

					platform {
						sound-dai = <0xffffffff>;
					};
				};

				rdma@3 {

					codec {
						sound-dai = <0x4>;
					};

					cpu {
						sound-dai = <0xffffffff 0x3>;
					};

					platform {
						sound-dai = <0xffffffff>;
					};
				};

				rdma@4 {

					codec {
						sound-dai = <0x4>;
					};

					cpu {
						sound-dai = <0xffffffff 0x4>;
					};

					platform {
						sound-dai = <0xffffffff>;
					};
				};

				rdma@5 {

					codec {
						sound-dai = <0x4>;
					};

					cpu {
						sound-dai = <0xffffffff 0x5>;
					};

					platform {
						sound-dai = <0xffffffff>;
					};
				};

				rdma@6 {

					codec {
						sound-dai = <0x4>;
					};

					cpu {
						sound-dai = <0xffffffff 0x6>;
					};

					platform {
						sound-dai = <0xffffffff>;
					};
				};

				rdma@7 {

					codec {
						sound-dai = <0x4>;
					};

					cpu {
						sound-dai = <0xffffffff 0x7>;
					};

					platform {
						sound-dai = <0xffffffff>;
					};
				};

				sifs0@0 {

					codec {
						sound-dai = <0x4>;
					};

					cpu {
						sound-dai = <0xffffffff 0xd>;
					};
				};

				sifs1@0 {

					codec {
						sound-dai = <0x4>;
					};

					cpu {
						sound-dai = <0xffffffff 0xe>;
					};
				};

				sifs2@0 {

					codec {
						sound-dai = <0x4>;
					};

					cpu {
						sound-dai = <0xffffffff 0xf>;
					};
				};

				spdy@0 {

					codec {
						sound-dai = <0x4>;
					};

					cpu {
						sound-dai = <0xffffffff>;
					};
				};

				uaif@0 {
					format = "i2s";

					codec {
						sound-dai = <0x5 0x0>;
					};

					cpu {
						sound-dai = <0xffffffff>;
					};
				};

				uaif@1 {
					format = "i2s";

					codec {
						sound-dai = <0x4>;
					};

					cpu {
						sound-dai = <0xffffffff>;
					};
				};

				uaif@2 {
					format = "i2s";

					codec {
						sound-dai = <0x6 0x0>;
					};

					cpu {
						sound-dai = <0xffffffff>;
					};

					platform {
						sound-dai = <0xffffffff 0x0>;
					};
				};

				uaif@4 {
					bitclock-master;
					format = "i2s";
					frame-master;

					codec {
						sound-dai = <0x4>;
					};

					cpu {
						sound-dai = <0xffffffff>;
					};
				};

				wdma@0 {

					codec {
						sound-dai = <0x4>;
					};

					cpu {
						sound-dai = <0xffffffff 0x8>;
					};

					platform {
						sound-dai = <0xffffffff>;
					};
				};

				wdma@1 {

					codec {
						sound-dai = <0x4>;
					};

					cpu {
						sound-dai = <0xffffffff 0x9>;
					};

					platform {
						sound-dai = <0xffffffff>;
					};
				};

				wdma@2 {

					codec {
						sound-dai = <0x4>;
					};

					cpu {
						sound-dai = <0xffffffff 0xa>;
					};

					platform {
						sound-dai = <0xffffffff>;
					};
				};

				wdma@3 {

					codec {
						sound-dai = <0x4>;
					};

					cpu {
						sound-dai = <0xffffffff 0xb>;
					};

					platform {
						sound-dai = <0xffffffff>;
					};
				};

				wdma@4 {

					codec {
						sound-dai = <0x4>;
					};

					cpu {
						sound-dai = <0xffffffff 0xc>;
					};

					platform {
						sound-dai = <0xffffffff>;
					};
				};
			};
		};
	};
};
